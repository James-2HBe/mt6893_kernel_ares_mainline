// SPDX-License-Identifier: GPL-2.0-only
/*
 * Xiaomi Redmi K40 Gaming / POCO F3 GT (ares) — 板级设备树（官方全量数据版 v3）
 *
 * 目标: Linux 主线 7.3.3 内核（arch/arm64/boot/dts/mediatek/）
 *
 * 数据来源（全部来自原厂仓库 MiCode/Xiaomi_Kernel_OpenSource @ ares-r-oss, 4.14）:
 *   - 基础节点: mediatek/mt6893.dts + mediatek/mt6360.dtsi + mt6360_pd.dtsi
 *   - 电池节点: mediatek/bat_setting/mt6893_battery_{prop,table,prop_dim2_ext}.dtsi
 *   - 板级外设: 用户上传 lineage-23.2 三份 + 官方 k6893v1_64.dts
 *   - SoC 层:   本仓库已有 mt6893.dtsi（不重复移植）
 *
 * v3 相对 v2：6 个最小桩全部消除（2 个换官方真值、4 个为死引用直接删）。
 * 由 tools/assemble_ares_dts_v3.py 生成，请勿手工编辑后覆盖。
 */

/dts-v1/;

/* 官方 ares defconfig 的条件编译取值（保留 #ifdef 由 cpp 处理） */

#define CONFIG_MICROTRUST_TEE_SUPPORT 1
#define CONFIG_MTK_SEC_VIDEO_PATH_SUPPORT 1
#define CONFIG_MTK_CAM_SECURITY_SUPPORT 1

#include "mt6893.dtsi"
#include "mt6893-pinfunc.h"
#include <dt-bindings/interrupt-controller/irq.h>
#include <dt-bindings/interrupt-controller/arm-gic.h>
#include <dt-bindings/spmi/spmi.h>


/* ══════════════ 硬件批次选择器（主线 cpp 预处理；改这里即可切换）══════════════
 * ares 存在多个触控 IC 批次与触觉 IC 挂载总线，官方 4.14 靠 defconfig 二选一；
 * 主线 dts 没有 defconfig，故用 cpp 宏在编译期消解资源冲突：GPIO20/21 + IRQ21
 * 只能属于一个触控设备，GPIO129/22 只能属于一个触觉设备。
 *
 * 数据依据：MiCode/Xiaomi_Kernel_OpenSource @ ares-r-oss（原厂）
 *          James-2HBe/kernel_mt6893 @ chopin_kvm（chopin/ares 真机测过）
 * 默认取「有主线移植驱动」且「原厂 ares-r-oss」的组合：GT9886 + i2c7。
 * 真机判别：dmesg 看触控 IC 自报 ID / i2c 探测 0x5d 与 0x5a 落在哪条总线。
 */
#define ARES_TOUCH_GT9886   1
#define ARES_TOUCH_FT3658U  2
#define ARES_TOUCH_GT9896S  3
#define ARES_TOUCH_VARIANT  ARES_TOUCH_GT9886   /* 按真机批次改这一行 */

#define ARES_HAPTIC_I2C7    1
#define ARES_HAPTIC_I2C9    2
#define ARES_HAPTIC_BUS     ARES_HAPTIC_I2C7    /* 原厂 ares-r-oss 用 i2c7 */


/ {
	model = "Xiaomi Redmi K40 Gaming (ares)";
	compatible = "xiaomi,ares", "mediatek,mt6893";
	interrupt-parent = <&gic>;
	/* 与官方根 dts 一致：SoC 层 reg 均为 <0 addr 0 size> */
	#address-cells = <0x02>;
	#size-cells = <0x02>;

	/* ══════════ 基础节点：移植自官方 ares-r-oss mt6893.dts ══════════ */

	/* [chosen] */
	chosen: chosen {
		bootargs = "console=tty0 console=ttyS0,921600n1 root=/dev/ram \
vmalloc=400M slub_debug=OFZPU swiotlb=noforce \
firmware_class.path=/vendor/firmware \
page_owner=on loop.max_part=7";
		kaslr-seed = <0 0>;
	};

	/* [reserved_memory] */
	reserved_memory: reserved-memory {
		#address-cells = <2>;
		#size-cells = <2>;
		ranges;

		zmc-default {
			compatible = "mediatek,zone_movable_cma";
			size = <0 0x2d000000>;
			alignment = <0 0x1000000>;
			alloc-ranges = <0 0xc0000000 4 0x00000000>;
		};

		ion-carveout-heap {
			compatible = "mediatek,ion-carveout-heap";
			no-map;
#ifdef CONFIG_FPGA_EARLY_PORTING
			size = <0 0x10000000>;
#else
			size = <0 0xc000>;
#endif
			alignment = <0 0x1000>;
			alloc-ranges = <0 0x40000000 0 0x80000000>;
		};

		consys-reserve-memory {
			compatible = "mediatek,consys-reserve-memory";
			no-map;
			size = <0 0x450000>;
			alignment = <0 0x100000>;
			alloc-ranges = <0 0x50000000 0 0x40000000>;
		};

		wifi_mem: wifi-reserve-memory {
			compatible = "shared-dma-pool";
			no-map;
			size = <0 0xF20000>;
			alignment = <0 0x1000000>;
			alloc-ranges = <0 0x40000000 0 0x80000000>;
		};

		gps-reserve-memory {
			compatible = "mediatek,gps-reserve-memory";
			no-map;
			size = <0 0x100000>;
			alignment = <0 0x100000>;
			alloc-ranges = <0 0x40000000 0 0x80000000>;
		};

#ifdef CONFIG_MICROTRUST_TEE_SUPPORT
		soter-shared-mem {
			compatible = "microtrust,shared_mem";
			no-map;
#if defined(CONFIG_MTK_SEC_VIDEO_PATH_SUPPORT) || \
	defined(CONFIG_MTK_CAM_SECURITY_SUPPORT)
			size = <0 0xc00000>;
			alignment = <0 0x1000000>;
#else
			size = <0 0x200000>;
			alignment = <0 0x200000>;
#endif
			alloc-ranges = <0 0x40000000 0 0x50000000>;
		};
#endif

		reserve-memory-sspm_share {
			compatible = "mediatek,reserve-memory-sspm_share";
			no-map;
			status = "okay";
#if defined(CONFIG_MTK_GMO_RAM_OPTIMIZE) || defined(CONFIG_MTK_MET_MEM_ALLOC)
			size = <0 0x110000>; /* 1M + 64K */
#else
			size = <0 0x910000>; /* 9M + 64K */
#endif
			alignment = <0 0x10000>;
			alloc-ranges = <0 0x40000000 0 0x60000000>;
		};

		reserve-memory-adsp_share {
			compatible = "mediatek,reserve-memory-adsp_share";
			no-map;
			size = <0 0x1000000>;
			alloc-ranges = <0 0x40000000 0 0x40000000>;
			alignment = <0 0x10000>; //EMI 64KB Align
		};
		reserve-memory-scp_share {
			compatible = "mediatek,reserve-memory-scp_share";
			no-map;
			size = <0 0x00500000>; /*5 MB share mem size */
			alignment = <0 0x1000000>;
			alloc-ranges = <0 0x50000000 0 0x40000000>;
		};
		reserve-memory-mcupm_share {
			compatible = "mediatek,reserve-memory-mcupm_share";
			no-map;
			status = "okay";
			size = <0 0x200000>; /* 2M  */
			alignment = <0 0x10000>;
			alloc-ranges = <0 0x40000000 0 0x60000000>;
		};
	};

	/* [gic] */
	gic: interrupt-controller {
		compatible = "arm,gic-v3";
		#interrupt-cells = <3>;
		#address-cells = <2>;
		#size-cells = <2>;
		#redistributor-regions = <1>;
		interrupt-parent = <&gic>;
		interrupt-controller;
		reg = <0 0x0c000000 0 0x40000>, // distributor
		      <0 0x0c040000 0 0x200000>; // redistributor
		interrupts = <GIC_PPI 9 IRQ_TYPE_LEVEL_HIGH>;
	};

	/* [clocks] */

	clocks {
		clk_null: clk_null {
			compatible = "fixed-clock";
			#clock-cells = <0>;
			clock-frequency = <0>;
		};

		clk26m: clk26m {
			compatible = "fixed-clock";
			#clock-cells = <0>;
			clock-frequency = <26000000>;
		};

		clk12m: clk12m {
			compatible = "fixed-clock";
			#clock-cells = <0>;
			clock-frequency = <12000000>;
		};

		clk32k: clk32k {
			compatible = "fixed-clock";
			#clock-cells = <0>;
			clock-frequency = <32000>;
		};
	};

	/* [mmc_fixed_3v3] */
	mmc_fixed_3v3: regulator-0 {
		compatible = "regulator-fixed";
		status = "disabled";
	};

	/* [mmc_fixed_1v8_io] */
	mmc_fixed_1v8_io: regulator-1 {
		compatible = "regulator-fixed";
		status = "disabled";
	};

	/* [extcon_usb] */
	extcon_usb: extcon_usb {
		compatible = "mediatek,extcon-usb";
	};

	/* [tboard_thermistor6] */
	tboard_thermistor6: thermal-sensor6 {
	compatible = "mediatek,mtboard-thermistor6";
	io-channels = <&auxadc 3>;
	io-channel-names = "thermistor-ch3";
	};

	/* [mtkfb] */
	mtkfb: mtkfb {
		compatible = "mediatek,mtkfb";
	};

	/* [camera_af_hw_node] */
	camera_af_hw_node: camera_af_hw_node {
		compatible = "mediatek,camera_af_lens";
	};

	/* [odm] */
	odm: odm {
		compatible = "simple-bus";
		/* reserved for overlay by odm */
	};

	/* [goodix_fp] */
	goodix_fp: fingerprint {
		compatible = "mediatek,fpc1022_irq", "mediatek,goodix-fp";
	};

	/* [accdet] */
	accdet: accdet {
		compatible = "mediatek,pmic-accdet";
	};

	/* [lk_charger] */
	lk_charger: lk_charger {
		compatible = "mediatek,lk_charger";
		enable_anime;
		/* enable_pe_plus; */
		enable_pd20_reset;
		power_path_support;
		max_charger_voltage = <6500000>;
		fast_charge_voltage = <3000000>;

		/* charging current */
		usb_charger_current = <500000>;
		ac_charger_current = <2050000>;
		ac_charger_input_current = <3200000>;
		non_std_ac_charger_current = <500000>;
		charging_host_charger_current = <1500000>;
		ta_ac_charger_current = <3000000>;
		pd_charger_current = <500000>;

		/* battery temperature protection */
		temp_t4_threshold = <50>;
		temp_t3_threshold = <45>;
		temp_t1_threshold = <0>;
	};

	/* [charger] */
	charger: charger {
		compatible = "mediatek,charger";
		algorithm_name = "SwitchCharging2";
		/* enable_sw_jeita; */
		/* enable_pe_plus; */
		/* enable_pe_2; */
		/* enable_pe_3; */
		/* enable_pe_4; */
		enable_type_c;
		power_path_support;
		enable_dynamic_mivr;

		/* common */
		battery_cv = <4350000>;
		max_charger_voltage = <6500000>;
		min_charger_voltage = <4600000>;

		/* dynamic mivr */
		min_charger_voltage_1 = <4400000>;
		min_charger_voltage_2 = <4200000>;
		max_dmivr_charger_current = <1400000>;

		/* charging current */
		usb_charger_current_suspend = <0>;
		usb_charger_current_unconfigured = <70000>;
		usb_charger_current_configured = <500000>;
		usb_charger_current = <500000>;
		ac_charger_current = <2050000>;
		ac_charger_input_current = <3200000>;
		non_std_ac_charger_current = <500000>;
		charging_host_charger_current = <1500000>;
		apple_1_0a_charger_current = <650000>;
		apple_2_1a_charger_current = <800000>;
		ta_ac_charger_current = <3000000>;

		/* sw jeita */
		jeita_temp_above_t4_cv = <4240000>;
		jeita_temp_t3_to_t4_cv = <4240000>;
		jeita_temp_t2_to_t3_cv = <4340000>;
		jeita_temp_t1_to_t2_cv = <4240000>;
		jeita_temp_t0_to_t1_cv = <4040000>;
		jeita_temp_below_t0_cv = <4040000>;
		temp_t4_thres = <50>;
		temp_t4_thres_minus_x_degree = <47>;
		temp_t3_thres = <45>;
		temp_t3_thres_minus_x_degree = <39>;
		temp_t2_thres = <10>;
		temp_t2_thres_plus_x_degree = <16>;
		temp_t1_thres = <0>;
		temp_t1_thres_plus_x_degree = <6>;
		temp_t0_thres = <0>;
		temp_t0_thres_plus_x_degree = <0>;
		temp_neg_10_thres = <0>;

		/* battery temperature protection */
		enable_min_charge_temp;
		min_charge_temp = <0>;
		min_charge_temp_plus_x_degree = <6>;
		max_charge_temp = <50>;
		max_charge_temp_minus_x_degree = <47>;

		/* PE */
		ta_12v_support;
		ta_9v_support;
		pe_ichg_level_threshold = <1000000>; /* uA */
		ta_ac_12v_input_current = <3200000>;
		ta_ac_9v_input_current = <3200000>;
		ta_ac_7v_input_current = <3200000>;

		/* PE 2.0 */
		pe20_ichg_level_threshold = <1000000>; /* uA */
		ta_start_battery_soc = <0>;
		ta_stop_battery_soc = <85>;

		/* PE 4.0 */
		high_temp_to_leave_pe40 = <46>;
		high_temp_to_enter_pe40 = <39>;
		low_temp_to_leave_pe40 = <10>;
		low_temp_to_enter_pe40 = <16>;

		/* PE 4.0 single charger*/
		pe40_single_charger_input_current = <3000000>;
		pe40_single_charger_current = <3000000>;

		/* PE 4.0 dual charger*/
		pe40_dual_charger_input_current = <3000000>;
		pe40_dual_charger_chg1_current = <2000000>;
		pe40_dual_charger_chg2_current = <2000000>;
		pe40_stop_battery_soc = <80>;

		/* PE 4.0 cable impedance (mohm) */
		pe40_r_cable_1a_lower = <576>;
		pe40_r_cable_2a_lower = <435>;
		pe40_r_cable_3a_lower = <293>;

		/* dual charger */
		chg1_ta_ac_charger_current = <1500000>;
		chg2_ta_ac_charger_current = <1500000>;
		slave_mivr_diff = <100000>;
		dual_polling_ieoc = <750000>;

		/* cable measurement impedance */
		cable_imp_threshold = <699>;
		vbat_cable_imp_threshold = <3900000>; /* uV */

		/* bif */
		bif_threshold1 = <4250000>;
		bif_threshold2 = <4300000>;
		bif_cv_under_threshold2 = <4450000>;

		/* PD */
		pd_vbus_low_bound = <5000000>;
		pd_vbus_upper_bound = <5000000>;
		pd_ichg_level_threshold = <1000000>; /* uA */
		pd_stop_battery_soc = <80>;

		ibus_err = <14>;
		vsys_watt = <5000000>;
	};

	/* [cp_qc30] */
	cp_qc30: cp_qc30 {
	};

	/* [usbpd_pm] */
	usbpd_pm: usbpd_pm {
	};

	/* [gamekey] */
	gamekey: gamekey {
		compatible = "xm,gamekey";
			key-gpios = <&pio 111 0x00>, <&pio 112 0x00>;	/* key_left/key_right */
			hall-gpios = <&pio 4 0x00>, <&pio 5 0x00>;	/* hall_left/hall_right */
	};

	/* [nfc_default] */
	nfc_default: nfc_default {
	};

	/* [kd_camera_hw1] */
	kd_camera_hw1:kd_camera_hw1@1a004000 {
		compatible = "mediatek,imgsensor";
	};

	/* ══════════ PMIC 节点：移植自官方 mt6360.dtsi ══════════ */

	/* [mt6360_pmu] */
	mt6360_pmu: mt6360_pmu_dts {
		status = "okay";
		mt6360,intr_gpio_num = <3>; /* direct defined GPIO num */
		mt6360,intr_gpio = <&pio 3 0x0>; /* GPIO */
		interrupt-controller;
		#interrupt-cells = <2>;
		adc: adc {
			compatible = "mediatek,mt6360_pmu_adc";
			interrupt-parent = <&mt6360_pmu>;
			interrupts = <41 0>, <43 0>, <44 0>;
			interrupt-names = "bat_ovp_adc_evt",
					  "adc_wakeup_evt",
					  "adc_donei";
			#io-channel-cells = <1>;
		};
		chg {
			compatible = "mediatek,mt6360_pmu_chg";
			interrupt-parent = <&mt6360_pmu>;
			interrupts = <4 0>, <6 0>, <7 0>, <9 0>,
				     <12 0>, <13 0>, <14 0>, <15 0>,
				     <27 0>, <29 0>, <32 0>, <35 0>,
				     <40 0>, <48 0>, <60 0>;
			interrupt-names = "chg_treg_evt", "chg_mivr_evt",
					  "pwr_rdy_evt", "chg_batsysuv_evt",
					  "chg_vsysuv_evt", "chg_vsysov_evt",
					  "chg_vbatov_evt", "chg_vbusov_evt",
					  "chg_tmri", "chg_adpbadi",
					  "chg_aiccmeasl", "wdtmri",
					  "pumpx_donei", "attachi",
					  "chrdet_ext_evt";
			io-channels = <&adc 0>, <&adc 1>, <&adc 3>, <&adc 4>,
				      <&adc 5>, <&adc 6>, <&adc 8>, <&adc 10>;
			io-channel-names = "USBID", "VBUSDIV5", "VSYS", "VBAT",
					   "IBUS", "IBAT", "TEMP_JC", "TS";
			chg_name = "primary_chg";
			ichg = <2000000>;		/* uA */
			aicr = <500000>;		/* uA */
			mivr = <4400000>;		/* uV */
			cv = <4350000>;			/* uA */
			ieoc = <150000>;		/* uA */
			safety_timer = <12>;		/* hour */
			ircmp_resistor = <25000>;	/* uohm */
			ircmp_vclamp = <32000>;		/* uV */
			en_te = <1>;
			en_wdt = <1>;
			aicc_once = <1>;
			post_aicc = <1>;
			batoc_notify = <0>;
		};
		fled {
			compatible = "mediatek,mt6360_pmu_fled";
			interrupt-parent = <&mt6360_pmu>;
			interrupts = <11 0>, <74 0>, <75 0>, <78 0>,
				     <79 0>;
			interrupt-names = "fled_chg_vinovp_evt", "fled_tx_evt",
					  "fled_lvf_evt", "fled2_short_evt",
					  "fled1_short_evt";
			/* 0: fixed mode, 1: tracking mode */
			fled_vmid_track = <0>;
			/* 64~2432ms, 32ms/step */
			fled_strb_tout = <1248>;
			/* 25000~400000uA, 12500uA/step */
			fled1_tor_cur = <37500>;
			/*
			 * 25000~750000uA, 6250uA/step
			 * 750000~1500000uA, 12500uA/step
			 */
			/*fled1_strb_cur = <800000>; */
			fled1_strb_cur = <750000>;
			/* 25000~400000uA, 12500uA/step */
			fled2_tor_cur = <37500>;
			/*
			 * 25000~750000uA, 6250uA/step
			 * 750000~1500000uA, 12500uA/step
			 */
			fled2_strb_cur = <800000>;
		};
		rgbled {
			compatible = "mediatek,mt6360_pmu_rgbled";
			mt,led_name = "red", "green",
				      "blue", "mt6360_pmu_led4";
			mt,led_default_trigger = "cc_mode", "cc_mode",
						 "cc_mode", "none";
		};
		core {
			compatible = "mediatek,mt6360_pmu_core";
			interrupt-parent = <&mt6360_pmu>;
			interrupts = <65 0>, <66 0>, <67 0>,
				     <68 0>, <69 0>, <70 0>,
				     <71 0>;
			interrupt-names = "ap_wdtrst_evt",
					  "en_evt",
					  "qonb_rst_evt",
					  "mrstb_evt",
					  "otp_evt",
					  "vddaov_evt",
					  "sysuv_evt";
			mren = <1>;
			apwdtrst_en = <1>;
			cc_open_sel = <3>;
			i2c_cc_open_tsel = <1>;
			ldo5_otp_en = <0>;
		};
	};

	/* [mt6360_pmic] */
	mt6360_pmic: mt6360_pmic_dts {
		status = "okay";
		interrupt-parent = <&mt6360_pmu>;
		interrupts = <96 0>, <100 0>, <101 0>, <102 0>,
			     <104 0>, <108 0>, <109 0>, <110 0>,
			     <118 0>, <119 0>, <126 0>, <127 0>;
		interrupt-names = "buck1_pgb_evt", "buck1_oc_evt",
				  "buck1_ov_evt", "buck1_uv_evt",
				  "buck2_pgb_evt", "buck2_oc_evt",
				  "buck2_ov_evt", "buck2_uv_evt",
				  "ldo6_oc_evt", "ldo7_oc_evt",
				  "ldo6_pgb_evt", "ldo7_pgb_evt";
		pwr_off_seq = [06 04 00 02];
		buck1 {
			regulator-compatible = "BUCK1";
			regulator-name = "VMDLA";
			regulator-min-microvolt = <300000>;
			regulator-max-microvolt = <1300000>;
			regulator-always-on;
		};
		buck2 {
			regulator-compatible = "BUCK2";
			regulator-name = "VDRAM1";
			regulator-min-microvolt = <300000>;
			regulator-max-microvolt = <1300000>;
			regulator-always-on;
		};
		ldo6 {
			regulator-compatible = "LDO6";
			regulator-name = "VMDDR";
			regulator-min-microvolt = <500000>;
			regulator-max-microvolt = <2100000>;
			regulator-always-on;
		};
		ldo7 {
			regulator-compatible = "LDO7";
			regulator-name = "VDRAM2";
			regulator-min-microvolt = <500000>;
			regulator-max-microvolt = <2100000>;
			regulator-always-on;
		};
	};

	/* [mt_pmic_vtp_ldo_reg] */
		mt_pmic_vtp_ldo_reg: ldo2 {
			regulator-compatible = "LDO2";
			regulator-name = "VTP";
			regulator-min-microvolt = <1200000>;
			regulator-max-microvolt = <3600000>;
		};

	/* [mt_pmic_vfp_ldo_reg] */
		mt_pmic_vfp_ldo_reg: ldo3 {
			regulator-compatible = "LDO3";
			regulator-name = "VFP";
			regulator-min-microvolt = <1200000>;
			regulator-max-microvolt = <3600000>;
		};

	/* [mt_pmic_vmch_ldo_reg] */
		mt_pmic_vmch_ldo_reg: ldo5 {
			regulator-compatible = "LDO5";
			regulator-name = "VMCH";
			regulator-min-microvolt = <2700000>;
			regulator-max-microvolt = <3600000>;
		};

	/* [mt6360_typec] 官方 mt6360_pd.dtsi */
	mt6360_typec: type_c_port0 {
		mt-dual,supported_modes = <0>; /* 0: dfp/ufp, 1: dfp, 2: ufp */
		mt-tcpc,name = "type_c_port0"; /* tcpc_device's name */
		/* 0: SNK Only, 1: SRC Only, 2: DRP, 3: Try.SRC, 4: Try.SNK */
		mt-tcpc,role_def = <4>;
		mt-tcpc,rp_level = <1>; /* 0: Default, 1: 1.5, 2: 3.0 */
		/* 0: Never, 1: Always, 2: EMarkOnly, 3: StartOnly */
		mt-tcpc,vconn_supply  = <1>;
#if (CONFIG_MTK_GAUGE_VERSION == 30)
		/* the number of notifier supply */
		mt-tcpc,notifier_supply_num = <3>;
#else
		/* the number of notifier supply */
		mt-tcpc,notifier_supply_num = <2>;
#endif
		mt6360pd,intr_gpio = <&pio 24 0x0>;
		mt6360pd,intr_gpio_num = <24>;
		mt6360pd,pcb_gpio = <&pio 16 0x0>;
		mt6360pd,pcb_gpio_num = <16>;
		/* 0: gpio low as phone, 1: gpio high as phone */
		mt6360pd,pcb_gpio_polarity = <0>;
		interrupt-parent = <&mt6360_pmu>;
		interrupts = <64 0>;
		interrupt-names = "usbid_evt";
		pd-data {
			pd,vid = <0x29cf>;
			pd,pid = <0x6360>;
			pd,source-cap-ext = <0x636029cf 0x00000000 0x00000000
					     0x00000000 0x00000000 0x07000000>;
			pd,mfrs = "RichtekTCPC";

			/*
			 *	VSAFE5V = 0, MAX_POWER = 1, CUSTOM = 2,
			 *	MAX_POWER_LV = 0x21, MAX_POWER_LVIC = 0x31
			 *	MAX_POWER_HV = 0x41, MAX_POWER_HVIC = 0x51
			 */
			pd,charging_policy= <0x31>;

			pd,source-pdo-size = <1>;
			pd,source-pdo-data = <0x00019096>; /* 5V, 1500 mA */
			pd,sink-pdo-size = <1>;
			pd,sink-pdo-data = <0x000190c8>;

			/*
			 * No DP, host + device
			 *	pd,id-vdo-size = <3>;
			 *	pd,id-vdo-data = <0xd10029cf 0x0 0x63600000>;
			 * With DP
			 *	pd,id-vdo-size = <3>;
			 *	pd,id-vdo-data = <0xd60029cf 0x0 0x63600000>;
			 */

			pd,id-vdo-size = <3>;
			pd,id-vdo-data = <0xd60029cf 0x0 0x63600000>;

			bat,nr = <1>;
			bat-info0 {
				bat,vid = <0x29cf>;
				bat,pid = <0x6360>;
				bat,mfrs = "bat1";
				bat,design_cap = <3000>;
			};
		};
		dpm_caps {
			local_dr_power;
			local_dr_data;
			// local_ext_power;
			local_usb_comm;
			// local_usb_suspend;
			// local_high_cap;
			// local_give_back;
			local_no_suspend;
			local_vconn_supply;

			// attemp_discover_cable_dfp;
			attemp_enter_dp_mode;
			attemp_discover_cable;
			attemp_discover_id;

			/* 0: disable, 1: prefer_snk, 2: prefer_src */
			pr_check = <0>;
			// pr_reject_as_source;
			// pr_reject_as_sink;
			// pr_check_gp_source;
			// pr_check_gp_sink;

			/* 0: disable, 1: prefer_ufp, 2: prefer_dfp */
			dr_check = <0>;
			// dr_reject_as_dfp;
			// dr_reject_as_ufp;
		};
		displayport {
			/* connection type = "both", "ufp_d", "dfp_d" */
			1st_connection = "dfp_d";
			2nd_connection = "dfp_d";
			signal,dp_v13;
			//signal,dp_gen2;
			usbr20_not_used;
			typec,receptacle;
			ufp_d {
				//pin_assignment,mode_a;
				//pin_assignment,mode_b;
				//pin_assignment,mode_c;
				//pin_assignment,mode_d;
				//pin_assignment,mode_e;
			};
			dfp_d {
				/* Only support mode C & D */
				//pin_assignment,mode_a;
				//pin_assignment,mode_b;
				pin_assignment,mode_c;
				pin_assignment,mode_d;
				pin_assignment,mode_e;
				pin_assignment,mode_f;
			};
		};
	};


	/* ══════════ 同 SoC 通用电源 / USB PHY（补 SoC 层悬空引用）══════════
	 * 来源：官方 cust_mt6885_msdc.dtsi 语义 + 同 SoC 官方 PMIC 电气值；
	 * 按主线 binding 重建，剔除显式 phandle 数值。非 ares 板级假数据。
	 * 电压：ufs_vcc=3.0V vusb33=3.3V otg_vbus=4.43~5.82V（十六进制换算）。
	 */
	ufs_fixed_vcc: regulator-ufs-vcc {
		compatible = "regulator-fixed";
		regulator-name = "vreg_ufs_vcc";
		regulator-min-microvolt = <3000000>;
		regulator-max-microvolt = <3000000>;
		regulator-always-on;
		regulator-boot-on;
	};

	vusb33: regulator-vusb33 {
		compatible = "regulator-fixed";
		regulator-name = "vusb33";
		regulator-min-microvolt = <3300000>;
		regulator-max-microvolt = <3300000>;
		regulator-always-on;
	};

	otg_vbus: usb-otg-vbus-regulator {
		compatible = "regulator-fixed";
		regulator-name = "usb-otg-vbus";
		regulator-min-microvolt = <5000000>;
		regulator-max-microvolt = <5000000>;
	};

	tphy: t-phy@11e40000 {
		compatible = "mediatek,mt6893-tphy", "mediatek,generic-tphy-v2";
		#address-cells = <0x01>;
		#size-cells = <0x01>;
		ranges = <0x0 0x0 0x11e40000 0x1000>;
		status = "okay";

		u2port: usb-phy@0 {
			reg = <0x0 0x1000>;
			clocks = <&clk26m>;
			clock-names = "ref";
			#phy-cells = <0x01>;
			mediatek,eye-vrt = <0x04>;
			mediatek,eye-term = <0x04>;
			mediatek,intr = <0x1e>;
			mediatek,discth = <0x07>;
			mediatek,force-session-valid;
			status = "okay";
		};
	};

	/* ══════════ 官方真实设备节点（原厂真值，非桩）══════════
	 * [irtx_pwm] 官方 mediatek/mt6893.dts L7475
	 * [bat_gm30] 官方 mediatek/bat_setting/mt6893_battery_prop.dtsi
	 *            由 CONFIG_MTK_GAUGE_VERSION=30 条件编译纳入，
	 *            含 537 行电池表 + dim2 ext 校准参数。
	 */

	/* [官方] irtx_pwm */
	irtx_pwm:irtx_pwm {
		compatible = "mediatek,irtx-pwm";
		pwm_ch = <3>;
		pwm_data_invert = <0>;
	};

	/* [官方] bat_gm30（含电池表 + dim2 ext）*/
/*
 * Copyright (C) 2018 MediaTek Inc.
 *
 * This program is free software; you can redistribute it and/or modify
 * it under the terms of the GNU General Public License version 2 as
 * published by the Free Software Foundation.
 *
 * This program is distributed in the hope that it will be useful,
 * but WITHOUT ANY WARRANTY; without even the implied warranty of
 * MERCHANTABILITY or FITNESS FOR A PARTICULAR PURPOSE.
 * See http://www.gnu.org/licenses/gpl-2.0.html for more details.
 */
bat_gm30: battery{
	compatible = "mediatek,bat_gm30";
	DIFFERENCE_FULLOCV_ITH = <(200)>;
/*	Charging termination current*/
	SHUTDOWN_1_TIME = <(5)>;
/*	If ui_soc shows 1% more than X minites, system will shutdown*/
	KEEP_100_PERCENT = <(1)>;
/*	The ui_soc will keep 100% until SOC drop X percents after unplugged*/
	R_FG_VALUE = <(5)>;
/*	R_sense resistance*/
	EMBEDDED_SEL = <(0)>;
/*	Configures whether using embedded battery or not*/
	PMIC_SHUTDOWN_CURRENT = <(20)>;
/*	System shutdown current*/
	FG_METER_RESISTANCE = <(100)>;
/*	The resistance of PCB*/
	CAR_TUNE_VALUE = <(100)>;
/*	Tune value for current measurement*/
	PMIC_MIN_VOL = <(33500)>;
/*	vboot voltage for gauge 0%*/
	POWERON_SYSTEM_IBOOT = <(500)>;
/*	power on system iboot*/
	SHUTDOWN_GAUGE0_VOLTAGE = <(34000)>;
/*	shutdown gauge 0% voltage*/
	TEMPERATURE_T0 = <(50)>;
/*	Battery temperature T0*/
	TEMPERATURE_T1 = <(25)>;
/*	Battery temperature T1*/
	TEMPERATURE_T2 = <(10)>;
/*	Battery temperature T2*/
	TEMPERATURE_T3 = <(0)>;
/*	Battery temperature T3*/
	TEMPERATURE_T4 = <(-10)>;
/*	Battery temperature T4*/
	g_FG_PSEUDO100_T0 = <(100)>;
/*	Pseudo 100% percentage at T0*/
	g_FG_PSEUDO100_T1 = <(100)>;
/*	Pseudo 100% percentage at T1*/
	g_FG_PSEUDO100_T2 = <(100)>;
/*	Pseudo 100% percentage at T2*/
	g_FG_PSEUDO100_T3 = <(100)>;
/*	Pseudo 100% percentage at T3*/
	g_FG_PSEUDO100_T4 = <(100)>;
/*	Pseudo 100% percentage at T4*/
	Q_MAX_SYS_VOLTAGE_BAT0 = <(3350)>;
/*	Pseudo1 for hide percentage*/
	Q_MAX_SYS_VOLTAGE_BAT1 = <(3350)>;
/*	Pseudo1 for hide percentage*/
	Q_MAX_SYS_VOLTAGE_BAT2 = <(3350)>;
/*	Pseudo1 for hide percentage*/
	Q_MAX_SYS_VOLTAGE_BAT3 = <(3350)>;
/*	Pseudo1 for hide percentage*/
	COM_FG_METER_RESISTANCE = <(100)>;
/*	compensate The resistance of PCB*/
	COM_R_FG_VALUE = <(0)>;
/*	compensate R_sense resistance*/
	enable_tmp_intr_suspend = <(0)>;
/* Enable update temp when suspend */
	ACTIVE_TABLE = <(0)>;
/* Table numbers per battery*/
	MULTI_TEMP_GAUGE0 = <(1)>;
/* Multi gauge0 enable*/
	/* [官方] mt6893_battery_table.dtsi */
battery0_profile_t0_num = <100>;
battery0_profile_t0_col = <3>;
battery0_profile_t0 =
<
0       43220   1275
305     43058   1275
611     42936   1300
916     42814   1303
1221    42702   1352
1526    42589   1373
1832    42467   1353
2137    42347   1375
2442    42233   1375
2747    42113   1379
3053    42001   1400
3358    41891   1400
3663    41789   1395
3968    41683   1375
4274    41565   1387
4579    41463   1425
4884    41359   1433
5189    41254   1442
5495    41145   1425
5800    41040   1434
6105    40932   1440
6410    40834   1435
6716    40747   1471
7021    40678   1544
7326    40605   1577
7631    40489   1526
7937    40352   1500
8242    40214   1500
8547    40103   1539
8852    40011   1548
9158    39942   1567
9463    39880   1614
9768    39820   1640
10073   39763   1635
10379   39683   1609
10684   39611   1648
10989   39530   1675
11294   39452   1692
11600   39353   1683
11905   39227   1621
12210   39087   1563
12515   38967   1475
12821   38871   1469
13126   38787   1455
13431   38706   1390
13736   38641   1375
14042   38588   1375
14347   38536   1353
14652   38476   1327
14957   38433   1325
15263   38383   1349
15568   38332   1326
15873   38291   1349
16178   38250   1325
16484   38210   1325
16789   38169   1301
17094   38139   1352
17399   38108   1398
17705   38076   1375
18010   38027   1375
18315   37998   1378
18620   37977   1403
18926   37957   1429
19231   37935   1454
19536   37906   1475
19841   37884   1470
20147   37856   1461
20452   37833   1500
20757   37800   1481
21062   37759   1425
21368   37718   1418
21673   37684   1408
21978   37657   1417
22283   37613   1400
22589   37566   1382
22894   37529   1350
23199   37494   1340
23504   37457   1336
23810   37431   1362
24115   37396   1375
24420   37345   1388
24725   37284   1361
25031   37223   1338
25336   37172   1364
25641   37116   1389
25946   37037   1371
26252   36964   1365
26557   36934   1375
26862   36924   1391
27167   36913   1433
27473   36903   1450
27778   36879   1502
28083   36827   1561
28388   36628   1557
28694   36224   1550
28999   35690   1626
29304   34959   1748
29609   33864   2054
29915   31672   11079
30220   28030   6625
>;
battery0_profile_t1_num = <100>;
battery0_profile_t1_col = <3>;
battery0_profile_t1 =
<
0       43220   1275
305     43058   1275
611     42936   1300
916     42814   1303
1221    42702   1352
1526    42589   1373
1832    42467   1353
2137    42347   1375
2442    42233   1375
2747    42113   1379
3053    42001   1400
3358    41891   1400
3663    41789   1395
3968    41683   1375
4274    41565   1387
4579    41463   1425
4884    41359   1433
5189    41254   1442
5495    41145   1425
5800    41040   1434
6105    40932   1440
6410    40834   1435
6716    40747   1471
7021    40678   1544
7326    40605   1577
7631    40489   1526
7937    40352   1500
8242    40214   1500
8547    40103   1539
8852    40011   1548
9158    39942   1567
9463    39880   1614
9768    39820   1640
10073   39763   1635
10379   39683   1609
10684   39611   1648
10989   39530   1675
11294   39452   1692
11600   39353   1683
11905   39227   1621
12210   39087   1563
12515   38967   1475
12821   38871   1469
13126   38787   1455
13431   38706   1390
13736   38641   1375
14042   38588   1375
14347   38536   1353
14652   38476   1327
14957   38433   1325
15263   38383   1349
15568   38332   1326
15873   38291   1349
16178   38250   1325
16484   38210   1325
16789   38169   1301
17094   38139   1352
17399   38108   1398
17705   38076   1375
18010   38027   1375
18315   37998   1378
18620   37977   1403
18926   37957   1429
19231   37935   1454
19536   37906   1475
19841   37884   1470
20147   37856   1461
20452   37833   1500
20757   37800   1481
21062   37759   1425
21368   37718   1418
21673   37684   1408
21978   37657   1417
22283   37613   1400
22589   37566   1382
22894   37529   1350
23199   37494   1340
23504   37457   1336
23810   37431   1362
24115   37396   1375
24420   37345   1388
24725   37284   1361
25031   37223   1338
25336   37172   1364
25641   37116   1389
25946   37037   1371
26252   36964   1365
26557   36934   1375
26862   36924   1391
27167   36913   1433
27473   36903   1450
27778   36879   1502
28083   36827   1561
28388   36628   1557
28694   36224   1550
28999   35690   1626
29304   34959   1748
29609   33864   2054
29915   31672   11079
30220   28030   6625
>;
battery0_profile_t2_num = <100>;
battery0_profile_t2_col = <3>;
battery0_profile_t2 =
<
0       43030   2350
305     42868   2352
611     42746   2476
916     42623   2500
1221    42492   2500
1526    42371   2502
1832    42268   2522
2137    42155   2497
2442    42036   2479
2747    41933   2508
3053    41822   2559
3358    41719   2614
3663    41607   2680
3968    41497   2723
4274    41393   2812
4579    41283   2850
4884    41172   2826
5189    41060   2792
5495    40969   2808
5800    40884   2793
6105    40817   2844
6410    40752   2895
6716    40660   2915
7021    40520   2878
7326    40348   2861
7631    40184   2863
7937    40051   2874
8242    39939   2900
8547    39848   2913
8852    39778   2952
9158    39700   2975
9463    39625   2975
9768    39535   2945
10073   39423   2910
10379   39305   2853
10684   39195   2809
10989   39100   2783
11294   39016   2758
11600   38941   2750
11905   38863   2732
12210   38789   2762
12515   38732   2644
12821   38682   2542
13126   38615   2545
13431   38560   2691
13736   38517   2766
14042   38460   2544
14347   38406   2500
14652   38364   2545
14957   38323   2642
15263   38273   2697
15568   38232   2724
15873   38201   2749
16178   38170   2825
16484   38120   2801
16789   38079   2850
17094   38058   2850
17399   38019   2856
17705   37998   2950
18010   37966   2948
18315   37928   2928
18620   37907   2953
18926   37885   2979
19231   37853   2996
19536   37813   2966
19841   37774   2930
20147   37741   2950
20452   37703   2890
20757   37670   2681
21062   37629   2646
21368   37588   2737
21673   37548   2848
21978   37507   2941
22283   37456   2904
22589   37392   2684
22894   37345   2776
23199   37296   2940
23504   37226   2903
23810   37147   2752
24115   37086   2822
24420   37050   3000
24725   37024   3114
25031   36994   3123
25336   36980   2962
25641   36963   2907
25946   36921   3082
26252   36767   3205
26557   36424   3334
26862   35898   3512
27167   35196   3772
27473   34163   4179
27778   31846   10672
28083   28210   6725
28388   28210   6725
28694   28210   6725
28999   28210   6725
29304   28210   6725
29609   28210   6725
29915   28210   6725
30220   28210   6725
>;
battery0_profile_t3_num = <100>;
battery0_profile_t3_col = <3>;
battery0_profile_t3 =
<
0       42710   3800
305     42507   3802
611     42356   3904
916     42234   4001
1221    42112   4029
1526    41991   4077
1832    41887   4103
2137    41769   4150
2442    41675   4346
2747    41563   4491
3053    41451   4597
3358    41341   4686
3663    41239   4604
3968    41135   4485
4274    41028   4362
4579    40941   4461
4884    40874   4688
5189    40814   4866
5495    40718   4959
5800    40585   4865
6105    40425   4627
6410    40244   4590
6716    40080   4744
7021    39958   4908
7326    39840   4882
7631    39747   4670
7937    39671   4610
8242    39590   4751
8547    39503   4852
8852    39400   4859
9158    39300   4643
9463    39208   4471
9768    39111   4495
10073   39021   4571
10379   38940   4631
10684   38871   4715
10989   38810   4717
11294   38749   4751
11600   38681   4723
11905   38617   4449
12210   38563   4442
12515   38520   4644
12821   38472   4854
13126   38413   4743
13431   38376   4479
13736   38337   4528
14042   38296   4676
14347   38255   4833
14652   38196   4895
14957   38172   4946
15263   38123   4738
15568   38101   4581
15873   38071   4770
16178   38030   4949
16484   38000   5099
16789   37959   4990
17094   37938   4680
17399   37899   4793
17705   37888   5060
18010   37867   5175
18315   37835   5125
18620   37797   4767
18926   37775   4917
19231   37747   5158
19536   37724   5209
19841   37692   5245
20147   37649   5214
20452   37605   5193
20757   37577   5211
21062   37526   5079
21368   37470   5003
21673   37408   5035
21978   37364   5307
22283   37299   5475
22589   37215   5393
22894   37143   5212
23199   37092   5170
23504   37071   5211
23810   37046   5283
24115   37025   5459
24420   37010   5688
24725   36969   5930
25031   36870   6171
25336   36583   6275
25641   36098   6432
25946   35452   6815
26252   34524   7379
26557   32795   10134
26862   31040   13275
27167   31040   13275
27473   31040   13275
27778   31040   13275
28083   31040   13275
28388   31040   13275
28694   31040   13275
28999   31040   13275
29304   31040   13275
29609   31040   13275
29915   31040   13275
30220   31040   13275
>;
battery0_profile_t4_num = <100>;
battery0_profile_t4_col = <3>;
battery0_profile_t4 =
<
0       42150   10450
305     41905   10457
611     41641   10830
916     41368   10978
1221    41150   11043
1526    41010   11310
1832    40901   11696
2137    40805   11869
2442    40679   11818
2747    40522   11767
3053    40338   11703
3358    40157   11610
3663    39995   11618
3968    39875   11472
4274    39765   11363
4579    39668   11305
4884    39588   11274
5189    39514   11366
5495    39429   11467
5800    39337   11500
6105    39242   11490
6410    39144   11495
6716    39048   11473
7021    38955   11389
7326    38874   11352
7631    38792   11254
7937    38721   11138
8242    38665   11075
8547    38609   11063
8852    38548   11061
9158    38492   11022
9463    38441   10986
9768    38390   11079
10073   38339   11135
10379   38295   11172
10684   38254   11248
10989   38213   11242
11294   38166   11259
11600   38129   11327
11905   38091   11440
12210   38058   11622
12515   38035   11863
12821   37999   11752
13126   37974   11386
13431   37962   11541
13736   37935   11682
14042   37922   11826
14347   37902   11961
14652   37873   11930
14957   37852   11856
15263   37831   11709
15568   37820   11628
15873   37800   11894
16178   37760   12074
16484   37730   12227
16789   37699   12426
17094   37659   12482
17399   37627   12627
17705   37576   12648
18010   37526   12615
18315   37484   12548
18620   37433   12786
18926   37379   13236
19231   37306   13668
19536   37231   14167
19841   37178   14350
20147   37119   14361
20452   37070   14568
20757   37032   15293
21062   36994   16022
21368   36930   16541
21673   36846   16746
21978   36708   17128
22283   36456   17915
22589   36042   18243
22894   35445   18461
23199   34552   19491
23504   33138   17903
23810   30850   12800
24115   30850   12800
24420   30850   12800
24725   30850   12800
25031   30850   12800
25336   30850   12800
25641   30850   12800
25946   30850   12800
26252   30850   12800
26557   30850   12800
26862   30850   12800
27167   30850   12800
27473   30850   12800
27778   30850   12800
28083   30850   12800
28388   30850   12800
28694   30850   12800
28999   30850   12800
29304   30850   12800
29609   30850   12800
29915   30850   12800
30220   30850   12800
>;
	/* [官方] mt6893_battery_prop_dim2_ext.dtsi */
/*vboot voltage for gauge 0%*/
g_PMIC_MIN_VOL_row = <4>;
g_PMIC_MIN_VOL_col = <10>;
g_PMIC_MIN_VOL =
<
	33500  33500  33500  33500
	33000  33000  33000  33000
	33500  33500  33500  33500
	32200  32200  32200  32200
	31000  31000  31000  31000
	31500  31500  31500  31500
	31000  31000  31000  31000
	31000  31000  31000  31000
	31000  31000  31000  31000
	31000  31000  31000  31200
>;
/*boot_up current for gauge 0%*/
g_PON_SYS_IBOOT_row = <4>;
g_PON_SYS_IBOOT_col = <10>;
g_PON_SYS_IBOOT =
<
	5000  5000  5000  5000
	5000  5000  5000  5000
	5000  5000  5000  5000
	5000  5000  5000  5000
	5000  5000  5000  5000
	5000  5000  5000  5000
	5000  5000  5000  5000
	5000  5000  5000  5000
	5000  5000  5000  5000
	5000  5000  5000  5000
>;
/*Pseudo1 hide percentage*/
g_QMAX_SYS_VOL_row = <4>;
g_QMAX_SYS_VOL_col = <10>;
g_QMAX_SYS_VOL =
<
	34950  34950  34950  34950
	34950  34950  34950  34950
	34250  34250  34250  34250
	34250  34250  34250  34250
	34250  34250  34250  34250
	32500  32500  32500  32500
	32800  32800  32800  32800
	32800  32800  32800  32800
	32800  32800  32800  32800
	32800  32800  32800  32800
>;
/*Pseudo100 percentage setting*/
g_FG_PSEUDO100_row = <4>;
g_FG_PSEUDO100_col = <10>;
g_FG_PSEUDO100 =
<
	100  100  100  100
	100  100  100  100
	100  100  100  100
	100  100  100  100
	100  100  100  100
	100  100  100  100
	100  100  100  100
	100  100  100  100
	100  100  100  100
	100  100  100  100
>;
};

};


/* ══════════ &pio 引脚状态：全部移植自官方 mt6893.dts ══════════ */
&pio {

	/* [官方] nfc_int_active */
	nfc_int_active: nfc_int_active {
		pins_cmd_dat {
			pinmux = <PINMUX_GPIO11__FUNC_GPIO11>;
			slew-rate = <0>;
			drive-strength = <MTK_DRIVE_2mA>;
			bias-pull-up;
		};
	};

	/* [官方] nfc_int_suspend */
	nfc_int_suspend: nfc_int_suspend {
		pins_cmd_dat {
			pinmux = <PINMUX_GPIO11__FUNC_GPIO11>;
			slew-rate = <0>;
			drive-strength = <MTK_DRIVE_2mA>;
			bias-pull-up;
		};
	};

	/* [官方] nfc_enable_active */
	nfc_enable_active: nfc_enable_active {
		pins_cmd_dat {
			pinmux = <PINMUX_GPIO10__FUNC_GPIO10>;
			slew-rate = <1>;
			output-high;
			drive-strength = <MTK_DRIVE_2mA>;
			bias-pull-up=<MTK_PUPD_SET_R1R0_11>;
		};
	};

	/* [官方] nfc_enable_suspend */
	nfc_enable_suspend: nfc_enable_suspend {
		pins_cmd_dat {
			pinmux = <PINMUX_GPIO10__FUNC_GPIO10>;
			slew-rate = <1>;
			drive-strength = <MTK_DRIVE_2mA>;
			bias-disable;
		};
	};

};


/* ══════ 板级数据：official/k6893v1_64.dts — 官方 ares 项目底层配置 ══════ */
/*
 * Mediatek's mt6893 SoC device tree source
 *
 * Copyright (C) 2016 MediaTek Inc.
 * Copyright (C) 2021 XiaoMi, Inc.
 *
 * This program is free software; you can redistribute it and/or modify
 * it under the terms of the GNU General Public License version 2 as
 * published by the Free Software Foundation.
 *
 * This program is distributed in the hope that it will be useful,
 * but WITHOUT ANY WARRANTY; without even the implied warranty of
 * MERCHANTABILITY or FITNESS FOR A PARTICULAR PURPOSE.
 * See http://www.gnu.org/licenses/gpl-2.0.html for more details.
 */

&mmc_fixed_3v3 {
	status = "okay";
	regulator-name = "mmc_power";
	regulator-min-microvolt = <3300000>;
	regulator-max-microvolt = <3300000>;
	enable-active-high;
	regulator-always-on;
};

&mmc_fixed_1v8_io {
	status = "okay";
	regulator-name = "mmc_io";
	regulator-min-microvolt = <1800000>;
	regulator-max-microvolt = <1800000>;
	enable-active-high;
	regulator-always-on;
};

&reserved_memory {
};

/* chosen */
&chosen {

	atag,videolfb-fb_base_l = <0x7e020000>;
	atag,videolfb-fb_base_h = <0x0>;
	atag,videolfb-islcmfound = <1>;
	atag,videolfb-islcm_inited = <0>;
	atag,videolfb-fps= <6000>;
	atag,videolfb-vramSize= <0x1be0000>;
	atag,videolfb-lcmname=
		"nt35595_fhd_dsi_cmd_truly_nt50358_drv";
};

&mmc0 {
	status = "okay";
	/* pinctrl-names = "default", "state_uhs"; */
	/* pinctrl-0 = <&mmc0_pins_default>; */
	/* pinctrl-1 = <&mmc0_pins_uhs>; */
	bus-width = <8>;
	max-frequency = <5000000>;
	cap-mmc-highspeed;
	no-sdio;
	no-sd;
	vmmc-supply = <&mmc_fixed_3v3>;
	vqmmc-supply = <&mmc_fixed_1v8_io>;
	non-removable;
};

&odm {
	led0:led@0 {
		compatible = "mediatek,red";
		led_mode = <0>;
		data = <1>;
		pwm_config = <0 0 0 0 0>;
	};
	led1:led@1 {
		compatible = "mediatek,green";
		led_mode = <0>;
		data = <1>;
		pwm_config = <0 0 0 0 0>;
	};
	led2:led@2 {
		compatible = "mediatek,blue";
		led_mode = <0>;
		data = <1>;
		pwm_config = <0 0 0 0 0>;
	};
	led3:led@3 {
		compatible = "mediatek,jogball-backlight";
		led_mode = <0>;
		data = <1>;
		pwm_config = <0 0 0 0 0>;
	};
	led4:led@4 {
		compatible = "mediatek,keyboard-backlight";
		led_mode = <0>;
		data = <1>;
		pwm_config = <0 0 0 0 0>;
	};
	led5:led@5 {
		compatible = "mediatek,button-backlight";
		led_mode = <0>;
		data = <1>;
		pwm_config = <0 0 0 0 0>;
	};
	led6:led@6 {
		compatible = "mediatek,lcd-backlight";
		led_mode = <4>;
		data = <1>;
		pwm_config = <0 1 0 0 0>;
	};
	vibrator0:vibrator@0 {
		compatible = "mediatek,vibrator";
		vib_timer = <25>;
		vib_limit = <9>;
		vib_vol= <9>;
	};
	usb_c_pinctrl:usb_c_pinctrl {
		compatible = "mediatek,usb_c_pinctrl";
	};
};

/* DISPSYS GPIO standardization */
&pio {
	mtkfb_pins_lcm_rst_out1_gpio: lcm_rst_out1_gpio {
		pins_cmd_dat {
			pinmux = <PINMUX_GPIO42__FUNC_GPIO42>;
			slew-rate = <1>;
			output-high;
		};
	};

	mtkfb_pins_lcm_rst_out0_gpio: lcm_rst_out0_gpio {
		pins_cmd_dat {
			pinmux = <PINMUX_GPIO42__FUNC_GPIO42>;
			slew-rate = <1>;
			output-low;
		};
	};

	mtkfb_pins_lcm_dsi_te: lcm_dsi_te {
		pins_cmd_dat {
			pinmux = <PINMUX_GPIO41__FUNC_DSI_TE>;
		};
	};
};

&mtkfb {
	pinctrl-names = "lcm_rst_out1_gpio", "lcm_rst_out0_gpio",
		"mode_te_te";
	pinctrl-0 = <&mtkfb_pins_lcm_rst_out1_gpio>;
	pinctrl-1 = <&mtkfb_pins_lcm_rst_out0_gpio>;
	pinctrl-2 = <&mtkfb_pins_lcm_dsi_te>;
	status = "okay";
};

&dispsys_config {
	pinctrl-names =
		"lcm_rst_out1_gpio", "lcm_rst_out0_gpio",
		"mode_te_te";
	pinctrl-0 = <&mtkfb_pins_lcm_rst_out1_gpio>;
	pinctrl-1 = <&mtkfb_pins_lcm_rst_out0_gpio>;
	pinctrl-2 = <&mtkfb_pins_lcm_dsi_te>;
	status = "okay";
};
/* DISPSYS GPIO standardization end */

/* accdet start */
&accdet {
	/* accdet micbias voltage: 0x09:2.85v 0x08:2.8v 0x07,
	 * 2.7v;0x05,2.5v;0x02,1.9v
	 */
	accdet-mic-vol = <8>;
	/* accdet pwm_width, pwm_thresh, fall_delay, rise_delay
	 * debounce0, debounce1, debounce3, debounce4
	 * eint pwm_width, eint pwm_thresh
	 * eint deb(debounce0, debounce1, debounce2, debounce3), inv_debounce
	 */
	headset-mode-setting = <0x500 0x500 1 0x1f0
				0x800 0x800 0x20 0x44
				0x4 0x1
				0x5 0x3 0x3 0x5 0xe>;
	accdet-plugout-debounce = <1>;
	/*1:ACC mode, 2:low cost without in bias, 6:low cost with in bias*/
	accdet-mic-mode = <2>;
	/*0--MD_MAX--UP_MAX--DW_MAX*/
	headset-three-key-threshold = <0 80 220 400>;
	headset-three-key-threshold-CDD = <0 121 192 600>;
	/*0--MD_MAX--VOICE_MAX--UP_MAX--DW_MAX*/
	headset-four-key-threshold = <0 58 121 192 400>;

	/* select VTH to 2v and 500k, use internal resitance */
	eint_use_ext_res = <0>;
	status = "okay";
};
/* accdet end */

/* IRTX GPIO Start */
&irtx_pwm {
	/*pinctrl-names = "irtx_gpio_led_default", "irtx_gpio_led_set";
	pinctrl-0 = <&irtx_gpio_led_default>;
	pinctrl-1 = <&irtx_gpio_led_set>;
	status = "okay";*/
};
&pio {
	/* IRTX GPIO Settings -Start */
	/* default: GPIO0, output, high */
	/*irtx_gpio_led_default:irtx_gpio_led_def@gpio127 {
		pins_cmd_dat {
			pinmux = <PINMUX_GPIO127__FUNC_GPIO127>;
			slew-rate = <1>;
			bias-disable;
			output-low;
			input-schmitt-enable = <0>;
		};
	};

	irtx_gpio_led_set:irtx_gpio_led_set@gpio127 {
		pins_cmd_dat {
			pinmux = <PINMUX_GPIO127__FUNC_PWM_3>;
			slew-rate = <1>;
			output-high;
		};
	};*/
}; /* IRTX GPIO Settings -End */

/* FINGERPRINT start */
&spi1 {
	#address-cells = <1>;
	#size-cells = <0>;
	fingerprint@0 {
		compatible = "goodix,goodix-fp";
			reset-gpios = <&pio 14 0x0>;	/* &goodix_fp pinctrl GPIO14 */
			irq-gpios = <&pio 15 0x0>;	/* &goodix_fp fpc,gpio_irq = <&pio 15 0> */
		reg = <0>;
		spi-max-frequency = <8000000>;
		netlink-event = <30>;
		vfp-supply = <&mt_pmic_vfp_ldo_reg>;
		power-type = <1>;
		status = "okay";
	};
};

&goodix_fp {
	pinctrl-names = "default", "reset_high", "reset_low", "eint_init";
	pinctrl-0 = <&fingerprint_default>;
	pinctrl-1 = <&fingerprint_reset_high>;
	pinctrl-2 = <&fingerprint_reset_low>;
	pinctrl-3 = <&fingerprint_eint_init>;
	interrupt-parent = <&pio>;
	interrupts = <15 IRQ_TYPE_EDGE_RISING>;
	status = "okay";
};

&pio {
	fingerprint_default: state_default {
	};
	fingerprint_reset_high: state_reset_high {
		pins_cmd_dat {
			pinmux = <PINMUX_GPIO14__FUNC_GPIO14>;
			slew-rate = <1>;
			output-high;
		};
	};
	fingerprint_reset_low: state_reset_low {
		pins_cmd_dat {
			pinmux = <PINMUX_GPIO14__FUNC_GPIO14>;
			slew-rate = <1>;
			output-low;
		};
	};
	fingerprint_eint_init: state_eint_init {
		pins_cmd_dat {
			pinmux = <PINMUX_GPIO15__FUNC_GPIO15>;
			slew-rate = <0>;
			bias-pull-up = <MTK_PUPD_SET_R1R0_10>;
			input-schmitt-enable;
		};
	};
};
/* FINGERPRINT end */

/*TOUCH begin*/
/*mt_pmic_vs1_buck_reg*/
&regulators {
	touch_avdd_i2c_vreg: touch_avdd_i2c_vreg {
		compatible = "regulator-fixed";
		regulator-min-microvolt = <1800000>;
		regulator-max-microvolt = <1800000>;
		regulator-name = "touch_avdd_i2c_vreg";
		enable-active-high;
		gpio = <&pio 27 0>;
	};
};

&pio {
	ts_reset_active: ts_reset_active {
		pins_cmd_dat {
			pinmux = <PINMUX_GPIO20__FUNC_GPIO20>;
			output-high;
		};
	 };

	ts_int_active: ts_int_active {
		pins_cmd_dat {
			pinmux = <PINMUX_GPIO21__FUNC_GPIO21>;
			input-enable;
		};
	 };

	ts_reset_suspend: ts_reset_suspend {
		pins_cmd_dat {
			pinmux = <PINMUX_GPIO20__FUNC_GPIO20>;
			slew-rate = <1>;
			bias-pull-down;
		};
	 };

	ts_int_suspend: ts_int_suspend {
		pins_cmd_dat {
			pinmux = <PINMUX_GPIO21__FUNC_GPIO21>;
			slew-rate = <1>;
			bias-pull-down;
		};
	 };

	ts_release: ts_release {
		pins_cmd0_dat {
			pinmux = <PINMUX_GPIO20__FUNC_GPIO20>;
			slew-rate = <1>;
			bias-pull-up;
		};
		pins_cmd1_dat {
			pinmux = <PINMUX_GPIO21__FUNC_GPIO21>;
			slew-rate = <1>;
			bias-disable;
		};
	};

	ts_spi_mode: ts_spimode {
		pins_cmd_dat {
			pinmux = <PINMUX_GPIO0__FUNC_SPI6_CLK>,
					 <PINMUX_GPIO1__FUNC_SPI6_CSB>,
					 <PINMUX_GPIO2__FUNC_SPI6_MI>,
					 <PINMUX_GPIO3__FUNC_SPI6_MO>;
			drive-strength = <2>;
		};
	 };

};

&mt_pmic_vmch_ldo_reg {
	regulator-boot-on;
	regulator-min-microvolt = <3000000>;
	regulator-max-microvolt = <3300000>;
};

&spi6 {
	status = "okay";
	#address-cells = <1>;
	#size-cells = <0>;
	focaltech@0 {
		compatible = "focaltech,fts";
			#if ARES_TOUCH_VARIANT == ARES_TOUCH_FT3658U
				status = "okay";
			#else
				status = "disabled";
			#endif
		reg = <0x0>;
		spi-max-frequency = <6000000>;
		interrupt-parent = <&pio>;
		interrupts = <21 IRQ_TYPE_EDGE_FALLING>;
		pinctrl-names = "pmx_ts_active", "pmx_ts_suspend", "pmx_ts_release",
						"ft3658u_spi_mode";
		pinctrl-0 = <&ts_int_active &ts_reset_active>;
		pinctrl-1 = <&ts_int_suspend &ts_reset_suspend>;
		pinctrl-2 = <&ts_release>;
		pinctrl-3 = <&ts_spi_mode>;
		vdd-supply = <&mt_pmic_vmch_ldo_reg>;
		vcc_i2c-supply = <&touch_avdd_i2c_vreg>;
		focaltech,reset-gpio = <&pio 20 0x00>;
		focaltech,irq-gpio = <&pio 21 0x2008>;
		focaltech,max-touch-number = <10>;
		focaltech,display-coords = <0 0 1080 2400>;
	};
};
/*TOUCH end*/

&mt6360_pmu {
	mt6360,intr_gpio_num = <24>; /* direct defined GPIO num */
	mt6360,intr_gpio = <&pio 24 0x0>;
};

&mt6360_pmic {
	pwr_off_seq = [04 00 02 02];
};

&mt6360_typec {
	mt6360pd,intr_gpio_num = <25>; /* direct defined GPIO num */
	mt6360pd,intr_gpio = <&pio 25 0x0>;
};

/* USB SWITCH GPIO start
&pio {
	usb_default: usb_default {
	};

	gpio_redriver_c1_init: c1_init {
		pins_cmd_dat {
			pinmux = <PINMUX_GPIO113__FUNC_GPIO113>;
			slew-rate = <1>;
			output-low;
		};
	};

	gpio_redriver_c1_low: c1_low {
		pins_cmd_dat {
			pinmux = <PINMUX_GPIO113__FUNC_GPIO113>;
			slew-rate = <1>;
			output-low;
		};
	};

	gpio_redriver_c1_hiz: c1_highz {
		pins_cmd_dat {
			pinmux = <PINMUX_GPIO113__FUNC_GPIO113>;
			slew-rate= <0>;
			bias-disable;
		};
	};

	gpio_redriver_c1_high: c1_high {
		pins_cmd_dat {
			pinmux = <PINMUX_GPIO113__FUNC_GPIO113>;
			slew-rate = <1>;
			output-high;
		};
	};

	gpio_redriver_c2_init: c2_init {
		pins_cmd_dat {
			pinmux = <PINMUX_GPIO112__FUNC_GPIO112>;
			slew-rate = <1>;
			output-low;
		};
	};

	gpio_redriver_c2_low: c2_low {
		pins_cmd_dat {
			pinmux = <PINMUX_GPIO112__FUNC_GPIO112>;
			slew-rate = <1>;
			output-low;
		};
	};

	gpio_redriver_c2_hiz: c2_highz {
		pins_cmd_dat {
			pinmux = <PINMUX_GPIO112__FUNC_GPIO112>;
			slew-rate= <0>;
			bias-disable;
		};
	};

	gpio_redriver_c2_high: c2_high {
		pins_cmd_dat {
			pinmux = <PINMUX_GPIO112__FUNC_GPIO112>;
			slew-rate = <1>;
			output-high;
		};
	};

	gpio_u3_switch_sel1: u3_sw_sel1 {
		pins_cmd_dat {
			pinmux = <PINMUX_GPIO111__FUNC_GPIO111>;
			slew-rate = <1>;
			output-low;
		};
	};

	gpio_u3_switch_sel2: u3_sw_sel2 {
		pins_cmd_dat {
			pinmux = <PINMUX_GPIO111__FUNC_GPIO111>;
			slew-rate = <1>;
			output-high;
		};
	};

	gpio_u3_switch_enable: u3_sw_en {
	};

	gpio_u3_switch_disable: u3_sw_dis {
	};
};

&usb_c_pinctrl {
	pinctrl-names = "usb_default",
		"redrv_c1_init",
		"redrv_c1_low",
		"redrv_c1_hiz",
		"redrv_c1_high",
		"redrv_c2_init",
		"redrv_c2_low",
		"redrv_c2_hiz",
		"redrv_c2_high",
		"switch_sel1",
		"switch_sel2",
		"switch_enable",
		"switch_disable";

	pinctrl-0 = <&usb_default>;
	pinctrl-1 = <&gpio_redriver_c1_init>;
	pinctrl-2 = <&gpio_redriver_c1_low>;
	pinctrl-3 = <&gpio_redriver_c1_hiz>;
	pinctrl-4 = <&gpio_redriver_c1_high>;
	pinctrl-5 = <&gpio_redriver_c2_init>;
	pinctrl-6 = <&gpio_redriver_c2_low>;
	pinctrl-7 = <&gpio_redriver_c2_hiz>;
	pinctrl-8 = <&gpio_redriver_c2_high>;
	pinctrl-9 = <&gpio_u3_switch_sel1>;
	pinctrl-10 = <&gpio_u3_switch_sel2>;
	pinctrl-11 = <&gpio_u3_switch_enable>;
	pinctrl-12 = <&gpio_u3_switch_disable>;
	status = "okay";

	usb_switch-data {
		en_pin_num = <0>;
		en_pin_val = <0>;
		sel_pin_num = <111>;
		sel_pin_val = <1>;
		c1_pin_num = <113>;
		c1_pin_val = <2>;
		c2_pin_num = <112>;
		c2_pin_val = <1>;
	};
};
USB SWITCH GPIO end */

/* GPS GPIO standardization start */
&pio {
	gps_pins_default: gps_default {
	};

	gps_l1_lna_pins_ol: gps_l1_lna@0 {
		pins_cmd_dat {
			pinmux = <PINMUX_GPIO162__FUNC_GPIO162>;
			output-low;
		};
	};
	gps_l1_lna_pins_dsp_ctrl: gps_l1_lna@1 {
		pins_cmd_dat {
			pinmux = <PINMUX_GPIO162__FUNC_GPS_L1_ELNA_EN>;
		};
	};
	gps_l1_lna_pins_oh: gps_l1_lna@2 {
		pins_cmd_dat {
			pinmux = <PINMUX_GPIO162__FUNC_GPIO162>;
			output-high;
		};
	};

	gps_l5_lna_pins_ol: gps_l5_lna@0 {
		pins_cmd_dat {
			pinmux = <PINMUX_GPIO163__FUNC_GPIO163>;
			output-low;
		};
	};
	gps_l5_lna_pins_dsp_ctrl: gps_l5_lna@1 {
		pins_cmd_dat {
			pinmux = <PINMUX_GPIO163__FUNC_GPS_L5_ELNA_EN>;
		};
	};
	gps_l5_lna_pins_oh: gps_l5_lna@2 {
		pins_cmd_dat {
			pinmux = <PINMUX_GPIO163__FUNC_GPIO163>;
			output-high;
		};
	};
};

&gps {
	pinctrl-names = "default",
		"gps_l1_lna_disable",
		"gps_l1_lna_dsp_ctrl",
		"gps_l1_lna_enable",
		"gps_l5_lna_disable",
		"gps_l5_lna_dsp_ctrl",
		"gps_l5_lna_enable";
	pinctrl-0 = <&gps_pins_default>;
	pinctrl-1 = <&gps_l1_lna_pins_ol>;
	pinctrl-2 = <&gps_l1_lna_pins_dsp_ctrl>;
	pinctrl-3 = <&gps_l1_lna_pins_oh>;
	pinctrl-4 = <&gps_l5_lna_pins_ol>;
	pinctrl-5 = <&gps_l5_lna_pins_dsp_ctrl>;
	pinctrl-6 = <&gps_l5_lna_pins_oh>;
	status = "okay";
};
/* GPS GPIO standardization end */

&dsi0 {
	status = "okay";
	#address-cells = <1>;
	#size-cells = <0>;
	panel1@0 {
		compatible = "k10_42_02_0a_dsc_cmd,lcm";
		reg = <0>;
		pm-enable-gpios = <&pio 109 0>;
		te-gpios = <&pio 41 0>;
		reset-gpios = <&pio 42 0>;
		pinctrl-names = "default";
		port {
			panel_in: endpoint {
				remote-endpoint = <&dsi_out>;
			};
		};
	};
	ports {
		port {
			dsi_out: endpoint {
				remote-endpoint = <&panel_in>;
			};
		};
	};
};

/* AW8697 Haptic start */
&pio {
	aw8697_reset_high: aw8697_reset_reset {
		pins_cmd_dat {
			pinmux = <PINMUX_GPIO129__FUNC_GPIO129>;
			drive-strength = <2>;
			bias-disable;
			output-high;
		};
	};
	aw8697_reset_low: aw8697_reset_active {
		pins_cmd_dat {
			pinmux = <PINMUX_GPIO129__FUNC_GPIO129>;
			drive-strength = <2>;
			bias-disable;
			output-low;
		};
	};
	aw8697_interrupt: aw8697_interrupt_active {
		pins_cmd_dat {
			pinmux = <PINMUX_GPIO22__FUNC_GPIO22>;
			drive-strength = <2>;
			bias-pull-up;
			input-enable;
		};
	};
};

&i2c7 {
	status = "okay";
	aw8697_haptic@5a {
		compatible = "awinic,aw8697_haptic";
			#if ARES_HAPTIC_BUS == ARES_HAPTIC_I2C7
				status = "okay";
			#else
				status = "disabled";
			#endif
			reset-gpios = <&pio 129 0>;	/* 官方 reset-gpio = <&pio 129 0> */
			irq-gpios = <&pio 22 0>;	/* 官方 irq-gpio = <&pio 22 0> */
		reg = <0x5A>;
		reset-gpio = <&pio 129 0>;
		irq-gpio = <&pio 22 0>;
		vib_mode = < 0 >;   /*mode:   RAM mode->0; CONT mode -> 1*/
		vib_f0_pre = < 1700 >;
		vib_f0_cali_percen = < 7 >;
		vib_cont_drv_lev = < 106 >;
		vib_cont_drv_lvl_ov = < 106 >;
		vib_cont_td = < 0xef >;
		vib_cont_zc_thr = < 0x08f8 >;  /*hq 0x08F8 */
		vib_cont_num_brk = < 3 >;
		vib_f0_coeff = < 260 >; /*Don't modify it    2.604167*/
		vib_f0_trace_parameter = < 9 3 1 31 >;
		vib_bemf_config = < 0 0x08 0x03 0xf8 >;
		vib_sw_brake = < 0x2c >;
		vib_tset = < 0x1a >;
		vib_r_spare = < 0x68 >;
		vib_bstdbg = < 0x30 0xeb 0xd4 0 0 0 >;
		vib_effect_id_boundary = < 10 >;
		vib_effect_max = < 170 >;
		vib_trig_config = < 0 1 0 1 2
						0 1 0 1 2
						0 1 0 1 2 >;
		vib_bst_vol_default = < 0x10 >;
		vib_bst_vol_ram = < 0x11 >;
		vib_bst_vol_rtp = < 0x10 >;
		vib_rtp_time = < 20 20 20 20 20 20 20 20 20000 15000
				 15000 20000 25000 15000 30000 25000 20000 20000 20000 20000
				 20000 20000 20000 20000 20000 20000 20000 20000 20000 20000
				 20000 20000 20000 20000 20000 20000 20000 20000 20000 20000
				 20000 20000 20000 20000 20000 20000 20000 20000 20000 20000
				 20000 20000 20000 20000 20000 20000 20000 20000 20000 20000
				 20000 20000 20000 20000 20000 20000 20000 20000 20000 20000
				 20000 20000 20000 20000 20000 20000 20000 20000 20000 20000
				 20000 20000 20000 20000 20000 20000 20000 20000 20000 20000
				 20000 20000 20000 20000 20000 20000 20000 20000 20000 20000
				 20000 20000 20000 20000 20000 20000 20000 20000 20000 20000
				 20000 20000 20000 20000 20000 20000 20000 20000 20000 20000
				 20000 20000 20000 20000 20000 20000 20000 20000 20000 20000
				 20000 20000 20000 20000 20000 20000 20000 20000 20000 20000
				 20000 20000 20000 20000 20000 20000 20000 20000 20000 20000
				 20000 20000 20000 20000 20000 20000 20000 20000 20000 20000
				 20000 20000 20000 20000 20000 20000 20000 20000 20000 20000
				 20000 20000 20000 20000 20000 >;
		pinctrl-names = "aw8697_reset_reset","aw8697_reset_active","aw8697_interrupt_active";
		pinctrl-0 = <&aw8697_reset_low>;
		pinctrl-1 = <&aw8697_reset_high>;
		pinctrl-2 = <&aw8697_interrupt>;
		wf_0 {
			/*CLICK*/
			mtk,effect-id = <0>;
			mtk,wf-vmax-mv = <3600>;
			mtk,wf-pattern = [3e 3e];
			mtk,wf-brake-pattern = [02 01 00 00];
			mtk,wf-play-rate-us = <20000>;
		};
		wf_1 {
			/*DOUBLE CLICK*/
			mtk,effect-id = <1>;
			mtk,wf-vmax-mv = <3600>;
			mtk,wf-pattern = [7e 3e];
			mtk,wf-brake-pattern = [03 01 00 00];
			mtk,wf-play-rate-us = <20000>;
		};
		wf_2 {
			/*TICK*/
			mtk,effect-id = <2>;
			mtk,wf-vmax-mv = <3600>;
			mtk,wf-pattern = [7e 3e];
			mtk,wf-brake-pattern = [02 01 00 00];
			mtk,wf-play-rate-us = <20000>;
		};
		wf_3 {
			/*THUD*/
			mtk,effect-id = <3>;
			mtk,wf-vmax-mv = <3600>;
			mtk,wf-pattern = [3e 3e];
			mtk,wf-brake-pattern = [02 01 00 00];
			mtk,wf-play-rate-us = <20000>;
		};
		wf_4 {
			/*POP*/
			mtk,effect-id = <4>;
			mtk,wf-vmax-mv = <3600>;
			mtk,wf-pattern = [3e 3e];
			mtk,wf-brake-pattern = [02 01 00 00];
			mtk,wf-play-rate-us = <28000>;
		};
		wf_5 {
			/*HEAVY CLICK*/
			mtk,effect-id = <5>;
			mtk,wf-vmax-mv = <3600>;
			mtk,wf-pattern = [7e 7e 7e];
			mtk,wf-brake-pattern = [03 03 01 00];
			mtk,wf-play-rate-us = <20000>;
		};
		wf_6 {
			/*id 6*/
			mtk,effect-id = <6>;
			mtk,wf-vmax-mv = <3600>;
			mtk,wf-pattern = [3e 3e];
			mtk,wf-brake-pattern = [02 01 00 00];
			mtk,wf-play-rate-us = <20000>;
		};
		wf_7 {
			/*id 7*/
			mtk,effect-id = <7>;
			mtk,wf-vmax-mv = <3600>;
			mtk,wf-pattern = [3e 3e];
			mtk,wf-brake-pattern = [02 01 00 00];
			mtk,wf-play-rate-us = <20000>;
		};
		wf_8 {
			/*id 8*/
			mtk,effect-id = <8>;
			mtk,wf-vmax-mv = <3600>;
			mtk,wf-pattern = [3e 3e];
			mtk,wf-brake-pattern = [02 01 00 00];
			mtk,wf-play-rate-us = <20000>;
		};
		wf_9 {
			/*id 9*/
			mtk,effect-id = <9>;
			mtk,wf-vmax-mv = <3600>;
			mtk,wf-pattern = [3e 3e];
			mtk,wf-brake-pattern = [02 01 00 00];
			mtk,wf-play-rate-us = <20000>;
		};
	};
};
/* AW8697 Haptic end */

&pio {
	uart_gpio_enable: uart_gpio_enable@gpio101 {
		pins_cmd_dat {
			pinmux = <PINMUX_GPIO101__FUNC_GPIO101>;
			slew-rate = <1>;
			bias-disable;
			output-low;
		};
	};

	uart_gpio_disable: uart_gpio_disable@gpio101 {
		pins_cmd_dat {
			pinmux = <PINMUX_GPIO101__FUNC_GPIO101>;
			slew-rate = <1>;
			bias-disable;
			output-high;
		};
	};
};


&i2c9 {
	et7480: et7480@42 {
		status = "okay";
		compatible = "mediatek,et7480-audioswitch";
		reg = <0x42>;
		pinctrl-names = "uart_enable", "uart_disable";
		pinctrl-0 = <&uart_gpio_enable>;
		pinctrl-1 = <&uart_gpio_disable>;
	};
};

&accdet {
	/* accdet micbias voltage: 0x09:2.85v 0x08:2.8v 0x07,
	 * 2.7v;0x05,2.5v;0x02,1.9v
	 */
	accdet-mic-vol = <5>;

	/*1:ACC mode, 2:low cost without in bias, 6:low cost with in bias*/
	accdet-mic-mode = <2>;

	et7480-i2c-handle = <&et7480>;
};


/*End of this file, DO NOT ADD ANYTHING HERE*/


/* ══════ 板级数据：official/cust_mt6893_touch_1080x2300.dtsi — 官方触控 ══════ */
/*
 * Copyright (c) 2019 MediaTek Inc.
 *
 * This program is free software; you can redistribute it and/or modify
 * it under the terms of the GNU General Public License version 2 as
 * published by the Free Software Foundation.
 *
 * This program is distributed in the hope that it will be useful,
 * but WITHOUT ANY WARRANTY; without even the implied warranty of
 * MERCHANTABILITY or FITNESS FOR A PARTICULAR PURPOSE.  See the
 * GNU General Public License for more details.
 */
/* TOUCH start */
&i2c0 {
	clock-frequency = <400000>;
	pinctrl-names = "default", "ts_int_active",
		"ts_reset_active", "ts_int_suspend",
		"ts_reset_suspend", "ts_i2c_mode";
	pinctrl-0 = <&ctp_pins_default>;
	pinctrl-1 = <&ctp_ts_int_active>;
	pinctrl-2 = <&ctp_ts_reset_active>;
	pinctrl-3 = <&ctp_ts_int_suspend>;
	pinctrl-4 = <&ctp_ts_reset_suspend>;
	pinctrl-5 = <&ctp_ts_i2c_mode>;

	gt9886@5d {
		compatible = "goodix,gt9886";
			#if ARES_TOUCH_VARIANT == ARES_TOUCH_GT9886
				status = "okay";
			#else
				status = "disabled";
			#endif
			reset-gpios = <&pio 20 0x0>;	/* 官方 goodix,reset-gpio = <&pio 20 0x0> */
			irq-gpios = <&pio 21 0x0>;	/* 官方 goodix,irq-gpio = <&pio 21 0x0> */
		reg = <0x5d>;
		interrupt-parent = <&pio>;
		interrupts = <21 IRQ_TYPE_EDGE_FALLING>;
		vtouch-supply = <&mt_pmic_vtp_ldo_reg>;
		goodix,reset-gpio = <&pio 20 0x0>;
		goodix,irq-gpio = <&pio 21 0x0>;
		goodix,irq-flags = <2>; /* 1:rising, 2:falling;*/
		goodix,panel-max-id = <10>;
		goodix,panel-max-x = <1080>;
		goodix,panel-max-y = <2280>;
		goodix,panel-max-w = <256>;
		goodix,panel-max-p = <256>;
		goodix,input-max-x = <1080>;
		goodix,input-max-y = <2280>;
		goodix,panel-key-map = <158 172 217>; /*BACK,HOMEPAGE,SEARCH*/
		goodix,power-on-delay-us = <10000>; /*10ms*/
		goodix,power-off-delay-us = <5000>;
		goodix,firmware-version = "6893v01";
		goodix,config-version = "6893v01";
		/*goodix,swap-axis;*/
		/*goodix,x2x;*/
		/*goodix,y2y;*/
		goodix,pen-enable;
		goodix,key-of-pen = <331 332>;/*BTN_STYLUS, BTN_STYLUS2*/
		tpd-filter-enable = <0>;
		tpd-filter-pixel-density = <161>;
		tpd-filter-custom-prameters = <0 0 0 0 0 0 0 0 0 0 0 0>;
		tpd-filter-custom-speed = <0 0 0>;
	};

};

&spi4 {
	status = "okay";
	#address-cells = <1>;
	#size-cells = <0>;
	pinctrl-names = "default", "gt9896s_int_active",
		"gt9896s_reset_active", "gt9896s_int_suspend",
		"gt9896s_reset_suspend", "gt9896s_spi_mode";
	pinctrl-0 = <&ctp_gt9896s_pins_default>;
	pinctrl-1 = <&ctp_gt9896s_int_active>;
	pinctrl-2 = <&ctp_gt9896s_reset_active>;
	pinctrl-3 = <&ctp_gt9896s_int_suspend>;
	pinctrl-4 = <&ctp_gt9896s_reset_suspend>;
	pinctrl-5 = <&ctp_gt9896s_spi_mode>;

	gt9896s@0 {
		compatible = "goodix,gt9896s";
			#if ARES_TOUCH_VARIANT == ARES_TOUCH_GT9896S
				status = "okay";
			#else
				status = "disabled";
			#endif
		reg = <0>; //Same as CS ID
		spi-max-frequency = <1000000>;

		goodix,avdd-name = "vtouch";
		vtouch-supply = <&mt_pmic_vtp_ldo_reg>;
		goodix,reset-gpio = <&pio 20 0x0>;
		goodix,irq-gpio = <&pio 21 0x0>;
		goodix,irq-flags = <2>; /* 1:rising, 2:falling;*/
		goodix,panel-max-id = <10>;
		goodix,panel-max-x = <1080>;
		goodix,panel-max-y = <2300>;
		goodix,panel-max-w = <256>;
		goodix,panel-max-p = <256>;
		goodix,input-max-x = <1080>;
		goodix,input-max-y = <2300>;
		goodix,panel-key-map = <158 172 217>; /*BACK,HOMEPAGE,SEARCH*/
		goodix,power-on-delay-us = <10000>; /*10ms*/
		goodix,power-off-delay-us = <5000>;
		goodix,firmware-version = "6893v02";
		goodix,config-version = "6893v02";
		/*goodix,swap-axis;*/
		/*goodix,x2x;*/
		/*goodix,y2y;*/
		goodix,pen-enable;
		tpd-filter-enable = <0>;
		tpd-filter-pixel-density = <161>;
		tpd-filter-custom-prameters = <0 0 0 0 0 0 0 0 0 0 0 0>;
		tpd-filter-custom-speed = <0 0 0>;
	};

};

&pio {
	ctp_pins_default: eintdefault {
	};
	ctp_gt9896s_pins_default: pins_default {
	};
	ctp_ts_int_active: int_active {
		pins_cmd_dat {
			pinmux = <PINMUX_GPIO21__FUNC_GPIO21>;
			input-enable;
		};
	};
	ctp_ts_reset_active: reset_active {
		pins_cmd_dat {
			pinmux = <PINMUX_GPIO20__FUNC_GPIO20>;
			output-high;
		};
	};
	ctp_ts_int_suspend: int_suspend {
		pins_cmd_dat {
			pinmux = <PINMUX_GPIO21__FUNC_GPIO21>;
			output-low;
		};
	};
	ctp_ts_reset_suspend: reset_suspend {
		pins_cmd_dat {
			pinmux = <PINMUX_GPIO20__FUNC_GPIO20>;
			output-low;
		};
	};
	ctp_ts_i2c_mode: i2cmode_default {
		pins_cmd_dat {
			pinmux = <PINMUX_GPIO204__FUNC_SCL0>,
				<PINMUX_GPIO205__FUNC_SDA0>;
		};
	};
	ctp_ts_int_as_gpio: int_high {
		pins_cmd_dat {
			pinmux = <PINMUX_GPIO21__FUNC_GPIO21>;
			output-high;
		};
	};
	ctp_gt9896s_int_active: int1_active {
		pins_cmd_dat {
			pinmux = <PINMUX_GPIO21__FUNC_GPIO21>;
			input-enable;
		};
	};
	ctp_gt9896s_reset_active: reset1_active {
		pins_cmd_dat {
			pinmux = <PINMUX_GPIO20__FUNC_GPIO20>;
			output-high;
		};
	};
	ctp_gt9896s_int_suspend: int1_suspend {
		pins_cmd_dat {
			pinmux = <PINMUX_GPIO21__FUNC_GPIO21>;
			output-low;
		};
	};
	ctp_gt9896s_reset_suspend: reset1_suspend {
		pins_cmd_dat {
			pinmux = <PINMUX_GPIO20__FUNC_GPIO20>;
			output-low;
		};
	};
	ctp_gt9896s_spi_mode: spimode_default {
		pins_cmd_dat {
			pinmux = <PINMUX_GPIO18__FUNC_SPI4_C_MI>,
				<PINMUX_GPIO19__FUNC_SPI4_C_MO>,
				<PINMUX_GPIO204__FUNC_SPI4_C_CLK>,
				<PINMUX_GPIO205__FUNC_SPI4_C_CSB>;
			drive-strength = <2>;
		};
	};
};
/* TOUCH end */


/* ══════ 板级数据：xiaomi-mt6893-common.dtsi — 板级共用外设 (lineage-23.2) ══════ */
/*
 * Mediatek's mt6893 SoC device tree source
 *
 * Copyright (C) 2016 MediaTek Inc.
 *
 * This program is free software; you can redistribute it and/or modify
 * it under the terms of the GNU General Public License version 2 as
 * published by the Free Software Foundation.
 *
 * This program is distributed in the hope that it will be useful,
 * but WITHOUT ANY WARRANTY; without even the implied warranty of
 * MERCHANTABILITY or FITNESS FOR A PARTICULAR PURPOSE.
 * See http://www.gnu.org/licenses/gpl-2.0.html for more details.
 */

&mmc_fixed_3v3 {
	status = "okay";
	regulator-name = "mmc_power";
	regulator-min-microvolt = <3300000>;
	regulator-max-microvolt = <3300000>;
	enable-active-high;
	regulator-always-on;
};

&mmc_fixed_1v8_io {
	status = "okay";
	regulator-name = "mmc_io";
	regulator-min-microvolt = <1800000>;
	regulator-max-microvolt = <1800000>;
	enable-active-high;
	regulator-always-on;
};

&reserved_memory {
};

/* chosen */
&chosen {

	atag,videolfb-fb_base_l = <0x7e020000>;
	atag,videolfb-fb_base_h = <0x0>;
	atag,videolfb-islcmfound = <1>;
	atag,videolfb-islcm_inited = <0>;
	atag,videolfb-fps= <6000>;
	atag,videolfb-vramSize= <0x1be0000>;
	atag,videolfb-lcmname=
		"nt35595_fhd_dsi_cmd_truly_nt50358_drv";
};

&mmc0 {
	status = "okay";
	/* pinctrl-names = "default", "state_uhs"; */
	/* pinctrl-0 = <&mmc0_pins_default>; */
	/* pinctrl-1 = <&mmc0_pins_uhs>; */
	bus-width = <8>;
	max-frequency = <5000000>;
	cap-mmc-highspeed;
	no-sdio;
	no-sd;
	vmmc-supply = <&mmc_fixed_3v3>;
	vqmmc-supply = <&mmc_fixed_1v8_io>;
	non-removable;
};

&odm {
	led0:led@0 {
		compatible = "mediatek,red";
		led_mode = <0>;
		data = <1>;
		pwm_config = <0 0 0 0 0>;
	};
	led1:led@1 {
		compatible = "mediatek,green";
		led_mode = <0>;
		data = <1>;
		pwm_config = <0 0 0 0 0>;
	};
	led2:led@2 {
		compatible = "mediatek,blue";
		led_mode = <0>;
		data = <1>;
		pwm_config = <0 0 0 0 0>;
	};
	led3:led@3 {
		compatible = "mediatek,jogball-backlight";
		led_mode = <0>;
		data = <1>;
		pwm_config = <0 0 0 0 0>;
	};
	led4:led@4 {
		compatible = "mediatek,keyboard-backlight";
		led_mode = <0>;
		data = <1>;
		pwm_config = <0 0 0 0 0>;
	};
	led5:led@5 {
		compatible = "mediatek,button-backlight";
		led_mode = <0>;
		data = <1>;
		pwm_config = <0 0 0 0 0>;
	};
	led6:led@6 {
		compatible = "mediatek,lcd-backlight";
		led_mode = <4>;
		data = <1>;
		pwm_config = <0 1 0 0 0>;
	};
	vibrator0:vibrator@0 {
		compatible = "mediatek,vibrator";
		vib_timer = <25>;
		vib_limit = <9>;
		vib_vol= <11>;
	};
	usb_c_pinctrl:usb_c_pinctrl {
		compatible = "mediatek,usb_c_pinctrl";
	};
};

/* DISPSYS GPIO standardization */
&pio {
	mtkfb_pins_lcm_rst_out1_gpio: lcm_rst_out1_gpio {
		pins_cmd_dat {
			pinmux = <PINMUX_GPIO42__FUNC_GPIO42>;
			slew-rate = <1>;
			output-high;
		};
	};

	mtkfb_pins_lcm_rst_out0_gpio: lcm_rst_out0_gpio {
		pins_cmd_dat {
			pinmux = <PINMUX_GPIO42__FUNC_GPIO42>;
			slew-rate = <1>;
			output-low;
		};
	};

	mtkfb_pins_lcm_dsi_te: lcm_dsi_te {
		pins_cmd_dat {
			pinmux = <PINMUX_GPIO41__FUNC_DSI_TE>;
		};
	};
};

&mtkfb {
	pinctrl-names = "lcm_rst_out1_gpio", "lcm_rst_out0_gpio",
		"mode_te_te";
	pinctrl-0 = <&mtkfb_pins_lcm_rst_out1_gpio>;
	pinctrl-1 = <&mtkfb_pins_lcm_rst_out0_gpio>;
	pinctrl-2 = <&mtkfb_pins_lcm_dsi_te>;
	status = "okay";
};

&dispsys_config {
	pinctrl-names =
		"lcm_rst_out1_gpio", "lcm_rst_out0_gpio",
		"mode_te_te";
	pinctrl-0 = <&mtkfb_pins_lcm_rst_out1_gpio>;
	pinctrl-1 = <&mtkfb_pins_lcm_rst_out0_gpio>;
	pinctrl-2 = <&mtkfb_pins_lcm_dsi_te>;
	status = "okay";
};
/* DISPSYS GPIO standardization end */

/* accdet start */
&accdet {
	/* accdet micbias voltage: 0x09:2.85v 0x08:2.8v 0x07,
	 * 2.7v;0x05,2.5v;0x02,1.9v
	 */
	accdet-mic-vol = <8>;
	/* accdet pwm_width, pwm_thresh, fall_delay, rise_delay
	 * debounce0, debounce1, debounce3, debounce4
	 * eint pwm_width, eint pwm_thresh
	 * eint deb(debounce0, debounce1, debounce2, debounce3), inv_debounce
	 */
	headset-mode-setting = <0x500 0x500 1 0x1f0
				0x800 0x800 0x20 0x44
				0x4 0x1
				0x5 0x3 0x3 0x5 0xe>;
	accdet-plugout-debounce = <1>;
	/*1:ACC mode, 2:low cost without in bias, 6:low cost with in bias*/
	accdet-mic-mode = <2>;
	/*0--MD_MAX--UP_MAX--DW_MAX*/
	headset-three-key-threshold = <0 80 220 400>;
	headset-three-key-threshold-CDD = <0 121 192 600>;
	/*0--MD_MAX--VOICE_MAX--UP_MAX--DW_MAX*/
	headset-four-key-threshold = <0 58 121 192 400>;

	/* select VTH to 2v and 500k, use internal resitance */
	eint_use_ext_res = <0>;
	status = "okay";
};
/* accdet end */

/* IRTX GPIO Start */
&irtx_pwm {
	pwm_ch = <3>;
	pinctrl-names = "irtx_gpio_led_default", "irtx_gpio_led_set";
	pinctrl-0 = <&irtx_gpio_led_default>;
	pinctrl-1 = <&irtx_gpio_led_set>;
	status = "okay";
};
&pio {
	/* IRTX GPIO Settings -Start */
	/* default: GPIO0, output, high */
	irtx_gpio_led_default:irtx_gpio_led_def@gpio135 {
		pins_cmd_dat {
			pinmux = <PINMUX_GPIO135__FUNC_GPIO135>;
			slew-rate = <1>;
			bias-disable;
			output-low;
			input-schmitt-enable = <0>;
		};
	};

	irtx_gpio_led_set:irtx_gpio_led_set@gpio135 {
		pins_cmd_dat {
			pinmux = <PINMUX_GPIO135__FUNC_PWM_0>;
			slew-rate = <1>;
			output-high;
		};
	};
}; /* IRTX GPIO Settings -End */

/* FINGERPRINT start */
&spi1 {
	#address-cells = <1>;
	#size-cells = <0>;
	fingerprint@0 {
		compatible = "goodix,goodix-fp";
		reg = <0>;
		spi-max-frequency = <8000000>;
		netlink-event = <30>;
		vfp-supply = <&mt_pmic_vfp_ldo_reg>;
		power-type = <1>;
		status = "okay";
	};
};

&goodix_fp {
	pinctrl-names = "default", "reset_high", "reset_low", "eint_init", "spi_cs";
	pinctrl-0 = <&fingerprint_default>;
	pinctrl-1 = <&fingerprint_reset_high>;
	pinctrl-2 = <&fingerprint_reset_low>;
	pinctrl-3 = <&fingerprint_eint_init>;
        fpc,gpio_irq = <&pio 15 0>;
	pinctrl-4 = <&fingerprint_spi_cs>;
	interrupt-parent = <&pio>;
	interrupts = <15 IRQ_TYPE_EDGE_RISING>;
	status = "okay";
};

&pio {
	fingerprint_default: state_default {
	};
	fingerprint_reset_high: state_reset_high {
		pins_cmd_dat {
			pinmux = <PINMUX_GPIO14__FUNC_GPIO14>;
			slew-rate = <1>;
			output-high;
		};
	};
	fingerprint_reset_low: state_reset_low {
		pins_cmd_dat {
			pinmux = <PINMUX_GPIO14__FUNC_GPIO14>;
			slew-rate = <1>;
			output-low;
		};
	};
	fingerprint_eint_init: state_eint_init {
		pins_cmd_dat {
			pinmux = <PINMUX_GPIO15__FUNC_GPIO15>;
			slew-rate = <0>;
			bias-pull-up = <MTK_PUPD_SET_R1R0_10>;
			input-schmitt-enable;
		};
	};
	fingerprint_spi_cs: state_spi_cs {
		pins_cmd_dat {
			pinmux = <PINMUX_GPIO157__FUNC_SPI1_A_CSB>;
			slew-rate = <0>;
			bias-disable;
		};
	};
};
/* FINGERPRINT end */

&mt6360_pmu {
	mt6360,intr_gpio_num = <24>; /* direct defined GPIO num */
	mt6360,intr_gpio = <&pio 24 0x0>;
};

&mt6360_pmic {
	pwr_off_seq = [04 00 02 02];
};

&mt6360_typec {
	mt6360pd,intr_gpio_num = <25>; /* direct defined GPIO num */
	mt6360pd,intr_gpio = <&pio 25 0x0>;
};

/* USB SWITCH GPIO start
&pio {
	usb_default: usb_default {
	};

	gpio_redriver_c1_init: c1_init {
		pins_cmd_dat {
			pinmux = <PINMUX_GPIO113__FUNC_GPIO113>;
			slew-rate = <1>;
			output-low;
		};
	};

	gpio_redriver_c1_low: c1_low {
		pins_cmd_dat {
			pinmux = <PINMUX_GPIO113__FUNC_GPIO113>;
			slew-rate = <1>;
			output-low;
		};
	};

	gpio_redriver_c1_hiz: c1_highz {
		pins_cmd_dat {
			pinmux = <PINMUX_GPIO113__FUNC_GPIO113>;
			slew-rate= <0>;
			bias-disable;
		};
	};

	gpio_redriver_c1_high: c1_high {
		pins_cmd_dat {
			pinmux = <PINMUX_GPIO113__FUNC_GPIO113>;
			slew-rate = <1>;
			output-high;
		};
	};

	gpio_redriver_c2_init: c2_init {
		pins_cmd_dat {
			pinmux = <PINMUX_GPIO112__FUNC_GPIO112>;
			slew-rate = <1>;
			output-low;
		};
	};

	gpio_redriver_c2_low: c2_low {
		pins_cmd_dat {
			pinmux = <PINMUX_GPIO112__FUNC_GPIO112>;
			slew-rate = <1>;
			output-low;
		};
	};

	gpio_redriver_c2_hiz: c2_highz {
		pins_cmd_dat {
			pinmux = <PINMUX_GPIO112__FUNC_GPIO112>;
			slew-rate= <0>;
			bias-disable;
		};
	};

	gpio_redriver_c2_high: c2_high {
		pins_cmd_dat {
			pinmux = <PINMUX_GPIO112__FUNC_GPIO112>;
			slew-rate = <1>;
			output-high;
		};
	};

	gpio_u3_switch_sel1: u3_sw_sel1 {
		pins_cmd_dat {
			pinmux = <PINMUX_GPIO111__FUNC_GPIO111>;
			slew-rate = <1>;
			output-low;
		};
	};

	gpio_u3_switch_sel2: u3_sw_sel2 {
		pins_cmd_dat {
			pinmux = <PINMUX_GPIO111__FUNC_GPIO111>;
			slew-rate = <1>;
			output-high;
		};
	};

	gpio_u3_switch_enable: u3_sw_en {
	};

	gpio_u3_switch_disable: u3_sw_dis {
	};
};

&usb_c_pinctrl {
	pinctrl-names = "usb_default",
		"redrv_c1_init",
		"redrv_c1_low",
		"redrv_c1_hiz",
		"redrv_c1_high",
		"redrv_c2_init",
		"redrv_c2_low",
		"redrv_c2_hiz",
		"redrv_c2_high",
		"switch_sel1",
		"switch_sel2",
		"switch_enable",
		"switch_disable";

	pinctrl-0 = <&usb_default>;
	pinctrl-1 = <&gpio_redriver_c1_init>;
	pinctrl-2 = <&gpio_redriver_c1_low>;
	pinctrl-3 = <&gpio_redriver_c1_hiz>;
	pinctrl-4 = <&gpio_redriver_c1_high>;
	pinctrl-5 = <&gpio_redriver_c2_init>;
	pinctrl-6 = <&gpio_redriver_c2_low>;
	pinctrl-7 = <&gpio_redriver_c2_hiz>;
	pinctrl-8 = <&gpio_redriver_c2_high>;
	pinctrl-9 = <&gpio_u3_switch_sel1>;
	pinctrl-10 = <&gpio_u3_switch_sel2>;
	pinctrl-11 = <&gpio_u3_switch_enable>;
	pinctrl-12 = <&gpio_u3_switch_disable>;
	status = "okay";

	usb_switch-data {
		en_pin_num = <0>;
		en_pin_val = <0>;
		sel_pin_num = <111>;
		sel_pin_val = <1>;
		c1_pin_num = <113>;
		c1_pin_val = <2>;
		c2_pin_num = <112>;
		c2_pin_val = <1>;
	};
};
USB SWITCH GPIO end */

/* GPS GPIO standardization start */
&pio {
	gps_pins_default: gps_default {
	};

	gps_l1_lna_pins_ol: gps_l1_lna@0 {
		pins_cmd_dat {
			pinmux = <PINMUX_GPIO162__FUNC_GPIO162>;
			output-low;
		};
	};
	gps_l1_lna_pins_dsp_ctrl: gps_l1_lna@1 {
		pins_cmd_dat {
			pinmux = <PINMUX_GPIO162__FUNC_GPS_L1_ELNA_EN>;
		};
	};
	gps_l1_lna_pins_oh: gps_l1_lna@2 {
		pins_cmd_dat {
			pinmux = <PINMUX_GPIO162__FUNC_GPIO162>;
			output-high;
		};
	};

	gps_l5_lna_pins_ol: gps_l5_lna@0 {
		pins_cmd_dat {
			pinmux = <PINMUX_GPIO163__FUNC_GPIO163>;
			output-low;
		};
	};
	gps_l5_lna_pins_dsp_ctrl: gps_l5_lna@1 {
		pins_cmd_dat {
			pinmux = <PINMUX_GPIO163__FUNC_GPS_L5_ELNA_EN>;
		};
	};
	gps_l5_lna_pins_oh: gps_l5_lna@2 {
		pins_cmd_dat {
			pinmux = <PINMUX_GPIO163__FUNC_GPIO163>;
			output-high;
		};
	};
};

&gps {
	pinctrl-names = "default",
		"gps_l1_lna_disable",
		"gps_l1_lna_dsp_ctrl",
		"gps_l1_lna_enable",
		"gps_l5_lna_disable",
		"gps_l5_lna_dsp_ctrl",
		"gps_l5_lna_enable";
	pinctrl-0 = <&gps_pins_default>;
	pinctrl-1 = <&gps_l1_lna_pins_ol>;
	pinctrl-2 = <&gps_l1_lna_pins_dsp_ctrl>;
	pinctrl-3 = <&gps_l1_lna_pins_oh>;
	pinctrl-4 = <&gps_l5_lna_pins_ol>;
	pinctrl-5 = <&gps_l5_lna_pins_dsp_ctrl>;
	pinctrl-6 = <&gps_l5_lna_pins_oh>;
	status = "okay";
};
/* GPS GPIO standardization end */

/*
&i2c11 {
	clock-frequency = <400000>;
	aw2028@65 {
		compatible = "awinic,aw2028_i2c";
		reg = <0x65>;
		status = "okay";
	};
};
*/

/* AW8697 Haptic start */
&pio {
	aw8697_reset_high: aw8697_reset_reset {
		pins_cmd_dat {
			pinmux = <PINMUX_GPIO129__FUNC_GPIO129>;
			drive-strength = <2>;
			bias-disable;
			output-high;
		};
	};
	aw8697_reset_low: aw8697_reset_active {
		pins_cmd_dat {
			pinmux = <PINMUX_GPIO129__FUNC_GPIO129>;
			drive-strength = <2>;
			bias-disable;
			output-low;
		};
	};
	aw8697_interrupt: aw8697_interrupt_active {
		pins_cmd_dat {
			pinmux = <PINMUX_GPIO22__FUNC_GPIO22>;
			drive-strength = <2>;
			bias-pull-up;
			input-enable;
		};
	};
};

&i2c9 {
	status = "okay";
	aw8697_haptic@5a {
		compatible = "awinic,aw8697_haptic";
			#if ARES_HAPTIC_BUS == ARES_HAPTIC_I2C9
				status = "okay";
			#else
				status = "disabled";
			#endif
		reg = <0x5A>;
		reset-gpio = <&pio 129 0>;
		irq-gpio = <&pio 22 0>;
		vib_mode = < 0 >;   /*mode:   RAM mode->0; CONT mode -> 1*/
		vib_f0_pre = < 1700 >;
		vib_f0_cali_percen = < 7 >;
		vib_cont_drv_lev = < 60 >;
		vib_cont_drv_lvl_ov = < 60 >;
		vib_cont_td = < 0xef >;
		vib_cont_zc_thr = < 0x08f8 >;  /*hq 0x08F8 */
		vib_cont_num_brk = < 3 >;
		vib_f0_coeff = < 260 >; /*Don't modify it    2.604167*/
		vib_f0_trace_parameter = < 0x05 0x03 0x02 0x0f >;
		vib_bemf_config = < 0 0x08 0x03 0xf8 >;
		vib_sw_brake = < 0x2c >;
		vib_tset = < 0x1a >;
		vib_r_spare = < 0x68 >;
		vib_bstdbg = < 0x30 0xeb 0xd4 0 0 0 >;
		vib_effect_id_boundary = < 10 >;
		vib_effect_max = < 197 >;   /*vib_effect_max must bigger than vib_effect_id*/
		vib_trig_config = < 0 1 0 1 2
						0 1 0 1 2
						0 1 0 1 2 >;
		vib_bst_vol_default = < 0x11 >;
		vib_bst_vol_ram = < 0x11 >;
		vib_bst_vol_rtp = < 0x11 >;
		vib_rtp_time = < 20 20 20 20 20 20 20 20 20000 15000
				 15000 20000 25000 15000 30000 25000 20000 20000 20000 20000
				 20000 20000 20000 20000 20000 20000 20000 20000 20000 20000
				 20000 20000 20000 20000 20000 20000 20000 20000 20000 20000
				 20000 20000 20000 20000 20000 20000 20000 20000 20000 20000
				 20000 20000 20000 20000 20000 20000 20000 20000 20000 20000
				 20000 20000 20000 20000 20000 20000 20000 20000 20000 20000
				 20000 20000 20000 20000 20000 20000 20000 20000 20000 20000
				 20000 20000 20000 20000 20000 20000 20000 20000 20000 20000
				 20000 20000 20000 20000 20000 20000 20000 20000 20000 20000
				 20000 20000 20000 20000 20000 20000 20000 20000 20000 20000
				 20000 20000 20000 20000 20000 20000 20000 20000 20000 20000
				 20000 20000 20000 20000 20000 20000 20000 20000 20000 20000
				 20000 20000 20000 20000 20000 20000 20000 20000 20000 20000
				 20000 20000 20000 20000 20000 20000 20000 20000 20000 20000
				 20000 20000 20000 20000 20000 20000 20000 20000 20000 20000
				 20000 20000 20000 20000 20000 20000 20000 20000 20000 20000
				 20000 20000 20000 20000 20000 >;
		pinctrl-names = "aw8697_reset_reset","aw8697_reset_active","aw8697_interrupt_active";
		pinctrl-0 = <&aw8697_reset_low>;
		pinctrl-1 = <&aw8697_reset_high>;
		pinctrl-2 = <&aw8697_interrupt>;
		wf_0 {
			/*CLICK*/
			mtk,effect-id = <0>;
			mtk,wf-vmax-mv = <3600>;
			mtk,wf-pattern = [3e 3e];
			mtk,wf-brake-pattern = [02 01 00 00];
			mtk,wf-play-rate-us = <20000>;
		};
		wf_1 {
			/*DOUBLE CLICK*/
			mtk,effect-id = <1>;
			mtk,wf-vmax-mv = <3600>;
			mtk,wf-pattern = [7e 3e];
			mtk,wf-brake-pattern = [03 01 00 00];
			mtk,wf-play-rate-us = <20000>;
		};
		wf_2 {
			/*TICK*/
			mtk,effect-id = <2>;
			mtk,wf-vmax-mv = <3600>;
			mtk,wf-pattern = [7e 3e];
			mtk,wf-brake-pattern = [02 01 00 00];
			mtk,wf-play-rate-us = <20000>;
		};
		wf_3 {
			/*THUD*/
			mtk,effect-id = <3>;
			mtk,wf-vmax-mv = <3600>;
			mtk,wf-pattern = [3e 3e];
			mtk,wf-brake-pattern = [02 01 00 00];
			mtk,wf-play-rate-us = <20000>;
		};
		wf_4 {
			/*POP*/
			mtk,effect-id = <4>;
			mtk,wf-vmax-mv = <3600>;
			mtk,wf-pattern = [3e 3e];
			mtk,wf-brake-pattern = [02 01 00 00];
			mtk,wf-play-rate-us = <28000>;
		};
		wf_5 {
			/*HEAVY CLICK*/
			mtk,effect-id = <5>;
			mtk,wf-vmax-mv = <3600>;
			mtk,wf-pattern = [7e 7e 7e];
			mtk,wf-brake-pattern = [03 03 01 00];
			mtk,wf-play-rate-us = <20000>;
		};
		wf_6 {
			/*id 6*/
			mtk,effect-id = <6>;
			mtk,wf-vmax-mv = <3600>;
			mtk,wf-pattern = [3e 3e];
			mtk,wf-brake-pattern = [02 01 00 00];
			mtk,wf-play-rate-us = <20000>;
		};
		wf_7 {
			/*id 7*/
			mtk,effect-id = <7>;
			mtk,wf-vmax-mv = <3600>;
			mtk,wf-pattern = [3e 3e];
			mtk,wf-brake-pattern = [02 01 00 00];
			mtk,wf-play-rate-us = <20000>;
		};
		wf_8 {
			/*id 8*/
			mtk,effect-id = <8>;
			mtk,wf-vmax-mv = <3600>;
			mtk,wf-pattern = [3e 3e];
			mtk,wf-brake-pattern = [02 01 00 00];
			mtk,wf-play-rate-us = <20000>;
		};
		wf_9 {
			/*id 9*/
			mtk,effect-id = <9>;
			mtk,wf-vmax-mv = <3600>;
			mtk,wf-pattern = [3e 3e];
			mtk,wf-brake-pattern = [02 01 00 00];
			mtk,wf-play-rate-us = <20000>;
		};
	};
};


/* [去重] 本块是 i2c7 上 AW8697 的重复叠加定义（另一份见上文，
 * 带主线标准 *-gpios 契约）；默认不参与编译。数据保留供审计，
 * 需要改用本批次校准值时把下面的 #if 0 改成 #if 1 即可。 */
#if 0
&i2c7 {
	status = "okay";
	aw8697_haptic@5a {
		compatible = "awinic,aw8697_haptic";
			#if ARES_HAPTIC_BUS == ARES_HAPTIC_I2C7
				status = "okay";
			#else
				status = "disabled";
			#endif
		reg = <0x5A>;
		reset-gpio = <&pio 129 0>;
		irq-gpio = <&pio 22 0>;
		vib_mode = < 0 >;   /*mode:   RAM mode->0; CONT mode -> 1*/
		vib_f0_pre = < 1700 >;
		vib_f0_cali_percen = < 7 >;
		vib_cont_drv_lev = < 60 >;
		vib_cont_drv_lvl_ov = < 60 >;
		vib_cont_td = < 0xef >;
		vib_cont_zc_thr = < 0x08f8 >;  /*hq 0x08F8 */
		vib_cont_num_brk = < 3 >;
		vib_f0_coeff = < 260 >; /*Don't modify it    2.604167*/
		vib_f0_trace_parameter = < 0x05 0x03 0x02 0x0f >;
		vib_bemf_config = < 0 0x08 0x03 0xf8 >;
		vib_sw_brake = < 0x2c >;
		vib_tset = < 0x1a >;
		vib_r_spare = < 0x68 >;
		vib_bstdbg = < 0x30 0xeb 0xd4 0 0 0 >;
		vib_effect_id_boundary = < 10 >;
		vib_effect_max = < 197 >;   /*vib_effect_max must bigger than vib_effect_id*/
		vib_trig_config = < 0 1 0 1 2
						0 1 0 1 2
						0 1 0 1 2 >;
		vib_bst_vol_default = < 0x11 >;
		vib_bst_vol_ram = < 0x11 >;
		vib_bst_vol_rtp = < 0x11 >;
		vib_rtp_time = < 20 20 20 20 20 20 20 20 20000 15000
				 15000 20000 25000 15000 30000 25000 20000 20000 20000 20000
				 20000 20000 20000 20000 20000 20000 20000 20000 20000 20000
				 20000 20000 20000 20000 20000 20000 20000 20000 20000 20000
				 20000 20000 20000 20000 20000 20000 20000 20000 20000 20000
				 20000 20000 20000 20000 20000 20000 20000 20000 20000 20000
				 20000 20000 20000 20000 20000 20000 20000 20000 20000 20000
				 20000 20000 20000 20000 20000 20000 20000 20000 20000 20000
				 20000 20000 20000 20000 20000 20000 20000 20000 20000 20000
				 20000 20000 20000 20000 20000 20000 20000 20000 20000 20000
				 20000 20000 20000 20000 20000 20000 20000 20000 20000 20000
				 20000 20000 20000 20000 20000 20000 20000 20000 20000 20000
				 20000 20000 20000 20000 20000 20000 20000 20000 20000 20000
				 20000 20000 20000 20000 20000 20000 20000 20000 20000 20000
				 20000 20000 20000 20000 20000 20000 20000 20000 20000 20000
				 20000 20000 20000 20000 20000 20000 20000 20000 20000 20000
				 20000 20000 20000 20000 20000 20000 20000 20000 20000 20000
				 20000 20000 20000 20000 20000 >;
		pinctrl-names = "aw8697_reset_reset","aw8697_reset_active","aw8697_interrupt_active";
		pinctrl-0 = <&aw8697_reset_low>;
		pinctrl-1 = <&aw8697_reset_high>;
		pinctrl-2 = <&aw8697_interrupt>;
		wf_0 {
			/*CLICK*/
			mtk,effect-id = <0>;
			mtk,wf-vmax-mv = <3600>;
			mtk,wf-pattern = [3e 3e];
			mtk,wf-brake-pattern = [02 01 00 00];
			mtk,wf-play-rate-us = <20000>;
		};
		wf_1 {
			/*DOUBLE CLICK*/
			mtk,effect-id = <1>;
			mtk,wf-vmax-mv = <3600>;
			mtk,wf-pattern = [7e 3e];
			mtk,wf-brake-pattern = [03 01 00 00];
			mtk,wf-play-rate-us = <20000>;
		};
		wf_2 {
			/*TICK*/
			mtk,effect-id = <2>;
			mtk,wf-vmax-mv = <3600>;
			mtk,wf-pattern = [7e 3e];
			mtk,wf-brake-pattern = [02 01 00 00];
			mtk,wf-play-rate-us = <20000>;
		};
		wf_3 {
			/*THUD*/
			mtk,effect-id = <3>;
			mtk,wf-vmax-mv = <3600>;
			mtk,wf-pattern = [3e 3e];
			mtk,wf-brake-pattern = [02 01 00 00];
			mtk,wf-play-rate-us = <20000>;
		};
		wf_4 {
			/*POP*/
			mtk,effect-id = <4>;
			mtk,wf-vmax-mv = <3600>;
			mtk,wf-pattern = [3e 3e];
			mtk,wf-brake-pattern = [02 01 00 00];
			mtk,wf-play-rate-us = <28000>;
		};
		wf_5 {
			/*HEAVY CLICK*/
			mtk,effect-id = <5>;
			mtk,wf-vmax-mv = <3600>;
			mtk,wf-pattern = [7e 7e 7e];
			mtk,wf-brake-pattern = [03 03 01 00];
			mtk,wf-play-rate-us = <20000>;
		};
		wf_6 {
			/*id 6*/
			mtk,effect-id = <6>;
			mtk,wf-vmax-mv = <3600>;
			mtk,wf-pattern = [3e 3e];
			mtk,wf-brake-pattern = [02 01 00 00];
			mtk,wf-play-rate-us = <20000>;
		};
		wf_7 {
			/*id 7*/
			mtk,effect-id = <7>;
			mtk,wf-vmax-mv = <3600>;
			mtk,wf-pattern = [3e 3e];
			mtk,wf-brake-pattern = [02 01 00 00];
			mtk,wf-play-rate-us = <20000>;
		};
		wf_8 {
			/*id 8*/
			mtk,effect-id = <8>;
			mtk,wf-vmax-mv = <3600>;
			mtk,wf-pattern = [3e 3e];
			mtk,wf-brake-pattern = [02 01 00 00];
			mtk,wf-play-rate-us = <20000>;
		};
		wf_9 {
			/*id 9*/
			mtk,effect-id = <9>;
			mtk,wf-vmax-mv = <3600>;
			mtk,wf-pattern = [3e 3e];
			mtk,wf-brake-pattern = [02 01 00 00];
			mtk,wf-play-rate-us = <20000>;
		};
	};
};
#endif
/* AW8697 Haptic end */

&pio {
	uart_gpio_enable: uart_gpio_enable@gpio101 {
		pins_cmd_dat {
			pinmux = <PINMUX_GPIO101__FUNC_GPIO101>;
			slew-rate = <1>;
			bias-disable;
			output-low;
		};
	};

	uart_gpio_disable: uart_gpio_disable@gpio101 {
		pins_cmd_dat {
			pinmux = <PINMUX_GPIO101__FUNC_GPIO101>;
			slew-rate = <1>;
			bias-disable;
			output-high;
		};
	};
};


&i2c9 {
	et7480: et7480@42 {
		status = "okay";
		compatible = "mediatek,et7480-audioswitch";
		reg = <0x42>;
		pinctrl-names = "uart_enable", "uart_disable";
		pinctrl-0 = <&uart_gpio_enable>;
		pinctrl-1 = <&uart_gpio_disable>;
	};
};

&accdet {
	/* accdet micbias voltage: 0x09:2.85v 0x08:2.8v 0x07,
	 * 2.7v;0x05,2.5v;0x02,1.9v
	 */
	accdet-mic-vol = <5>;

	/*1:ACC mode, 2:low cost without in bias, 6:low cost with in bias*/
	accdet-mic-mode = <2>;

	et7480-i2c-handle = <&et7480>;
};

&pio {
	rcv_gpio_hight: rcv_gpio_hight {
		pins_cmd_dat {
			pinmux = <PINMUX_GPIO54__FUNC_GPIO54>;
			drive-strength = <2>;
			bias-disable;
			output-high;
		};
	};
	rcv_gpio_low: rcv_gpio_low {
		pins_cmd_dat {
			pinmux = <PINMUX_GPIO54__FUNC_GPIO54>;
			drive-strength = <2>;
			bias-disable;
			output-low;
		};
	};
};

/* Audio Start */
&i2c7 {
	status = "okay";
	cs35l41_bottom: cs35l41@40 {
		compatible = "cirrus,cs35l41";
		#sound-dai-cells = <0>;
		reg = <0x40>;
		reset-gpio = <&pio 30 0>;
		interrupt-parent = <&pio>;
		interrupts = <31 IRQ_TYPE_LEVEL_LOW>;
		irq-gpio = <&pio 31 0>;
		cirrus,boost-peak-milliamp = <4500>;
		cirrus,boost-ind-nanohenry = <1000>;
		cirrus,boost-cap-microfarad = <15>;
		cirrus,asp-sdout-hiz = <1>;
		cirrus,gpio-config2 {
			cirrus,gpio-src-select = <0x4>;
			cirrus,gpio-output-enable;
		};
	};

	cs35l41_top: cs35l41@42 {
		compatible = "cirrus,cs35l41";
		#sound-dai-cells = <0>;
		reg = <0x42>;
		reset-gpio = <&pio 30 0>;
		interrupt-parent = <&pio>;
		interrupts = <113 IRQ_TYPE_LEVEL_LOW>;
		irq-gpio = <&pio 113 0>;
		cirrus,boost-peak-milliamp = <4500>;
		cirrus,boost-ind-nanohenry = <1000>;
		cirrus,boost-cap-microfarad = <15>;
		cirrus,asp-sdout-hiz = <1>;
		cirrus,tuning-has-prefix;
		pinctrl-names = "rcv_gpio_hight", "rcv_gpio_low";
		pinctrl-0 = <&rcv_gpio_hight>;
		pinctrl-1 = <&rcv_gpio_low>;
		cirrus,gpio-config2 {
			cirrus,gpio-src-select = <0x4>;
			cirrus,gpio-output-enable;
		};
	};
};
/* Audio End */



/*GAMEKEY start*/
&gamekey {
    status = "okay";
    key_left = <&pio 111 0x00>;
    hall_left = <&pio 4 0x00>;
    key_right = <&pio 112 0x00>;
    hall_right = <&pio 5 0x00>;
    debounce_time = <5>;        /*unit in ms*/
    pinctrl-names = "gamekey_active", "gamekey_suspend";
    pinctrl-0 = <&gk_hall_act &gk_key_act>;
    pinctrl-1 = <&gk_hall_sup &gk_key_sup>;
};

&pio {
	gk_hall_act: gk_hall_act {
		pins_cmd0_dat {
			pinmux = <PINMUX_GPIO4__FUNC_GPIO4>;
			input-enable;
			bias-disable;
		};

		pins_cmd1_dat {
			pinmux = <PINMUX_GPIO5__FUNC_GPIO5>;
			input-enable;
			bias-disable;
		};
	};

	gk_hall_sup: gk_hall_sup {
	};

	gk_key_act: gk_key_act {
		pins_cmd0_dat {
			pinmux = <PINMUX_GPIO111__FUNC_GPIO111>;
			input-enable;
			bias-pull-up;
			drive-strength = <2>;
		};

		pins_cmd1_dat {
			pinmux = <PINMUX_GPIO112__FUNC_GPIO112>;
			input-enable;
			bias-pull-up;
			drive-strength = <2>;
		};
	};

	gk_key_sup: gk_key_sup {
		pins_cmd0_dat {
			pinmux = <PINMUX_GPIO111__FUNC_GPIO111>;
			bias-disable;
		};

		pins_cmd1_dat {
			pinmux = <PINMUX_GPIO112__FUNC_GPIO112>;
			bias-disable;
		};
	};
};
/*GAMEKEY end*/

//ST NFC for Mediateckstart
&i2c6 {
    st21nfc@08 {
      compatible = "mediatek,nfc";
      	reset-gpios = <&pio 10 0x0>;	/* 官方 gpio-rst-std = <&pio 10 0x0> */
      	irq-gpios = <&pio 11 0x00>;	/* 官方 gpio-irq-std = <&pio 11 0x00> */
      reg = <0x08>;
      gpio-irq = <11>;
      gpio-irq-std = <&pio 11 0x00>;
      interrupt-parent = <&pio>;
      interrupts = <11 IRQ_TYPE_LEVEL_HIGH>;
      gpio-rst = <10>;
      gpio-rst-std = <&pio 10 0x0>;
 //     st,clkreq_gpio = <&pio 25 0x0>;
      interrupt-names = "nfc_irq";
      pinctrl-names = "default", "nfc_active", "nfc_suspend";
      pinctrl-0 = <&nfc_default>;
      pinctrl-1 = <&nfc_int_active &nfc_enable_active>;
 //       &nfc_clk_req_active>;
      pinctrl-2 = <&nfc_int_suspend &nfc_enable_suspend>;
//         &nfc_clk_req_suspend>;
    };
        
};
//NFC end 

/*End of this file, DO NOT ADD ANYTHING HERE*/


/* ══════ 板级数据：cust_mt6893_camera.dtsi — 相机 (lineage-23.2 上传) ══════ */
/*
 * Copyright (c) 2020 MediaTek Inc.
 *
 * This program is free software; you can redistribute it and/or modify
 * it under the terms of the GNU General Public License version 2 as
 * published by the Free Software Foundation.
 *
 * This program is distributed in the hope that it will be useful,
 * but WITHOUT ANY WARRANTY; without even the implied warranty of
 * MERCHANTABILITY or FITNESS FOR A PARTICULAR PURPOSE.  See the
 * GNU General Public License for more details.
 */
&mt_pmic_vcamio_ldo_reg {
	regulator-default-on = <1>; /* 0:skip, 1: off, 2:on */
	status = "okay";
};

/* CAMERA GPIO standardization */
&pio {
	camera_pins_cam0_rst_0: cam0@0 {
		pins_cmd_dat {
			pinmux = <PINMUX_GPIO145__FUNC_GPIO145>;
			slew-rate = <1>;
			output-low;
		};
	};
	camera_pins_cam0_rst_1: cam0@1 {
		pins_cmd_dat {
			pinmux = <PINMUX_GPIO145__FUNC_GPIO145>;
			slew-rate = <1>;
			output-high;
		};
	};
	camera_pins_cam0_pnd_0: cam0@2 {
		pins_cmd_dat {
			pinmux = <PINMUX_GPIO146__FUNC_GPIO146>;
			slew-rate = <1>;
			output-low;
		};
	};
	camera_pins_cam0_pnd_1: cam0@3 {
		pins_cmd_dat {
			pinmux = <PINMUX_GPIO146__FUNC_GPIO146>;
			slew-rate = <1>;
			output-high;
		};
	};
	camera_pins_cam1_rst_0: cam1@0 {
		pins_cmd_dat {
			pinmux = <PINMUX_GPIO131__FUNC_GPIO131>;
			slew-rate = <1>;
			output-low;
		};
	};
	camera_pins_cam1_rst_1: cam1@1 {
		pins_cmd_dat {
			pinmux = <PINMUX_GPIO131__FUNC_GPIO131>;
			slew-rate = <1>;
			output-high;
		};
	};
	camera_pins_cam1_pnd_0: cam1@2 {
		pins_cmd_dat {
			pinmux = <PINMUX_GPIO146__FUNC_GPIO146>;
			slew-rate = <1>;
			output-low;
		};
	};
	camera_pins_cam1_pnd_1: cam1@3 {
		pins_cmd_dat {
			pinmux = <PINMUX_GPIO146__FUNC_GPIO146>;
			slew-rate = <1>;
			output-high;
		};
	};
	camera_pins_cam2_rst_0: cam2@0 {
		pins_cmd_dat {
			pinmux = <PINMUX_GPIO130__FUNC_GPIO130>;
			slew-rate = <1>;
			output-low;
		};
	};
	camera_pins_cam2_rst_1: cam2@1 {
		pins_cmd_dat {
			pinmux = <PINMUX_GPIO130__FUNC_GPIO130>;
			slew-rate = <1>;
			output-high;
		};
	};
	camera_pins_cam2_pnd_0: cam2@2 {
		pins_cmd_dat {
			pinmux = <PINMUX_GPIO146__FUNC_GPIO146>;
			slew-rate = <1>;
			output-low;
		};
	};
	camera_pins_cam2_pnd_1: cam2@3 {
		pins_cmd_dat {
			pinmux = <PINMUX_GPIO146__FUNC_GPIO146>;
			slew-rate = <1>;
			output-high;
		};
	};
	camera_pins_cam3_rst_0: cam3@0 {
		pins_cmd_dat {
			pinmux = <PINMUX_GPIO144__FUNC_GPIO144>;
			slew-rate = <1>;
			output-low;
		};
	};
	camera_pins_cam3_rst_1: cam3@1 {
		pins_cmd_dat {
			pinmux = <PINMUX_GPIO144__FUNC_GPIO144>;
			slew-rate = <1>;
			output-high;
		};
	};
	camera_pins_cam3_pnd_0: cam3@2 {
		pins_cmd_dat {
			pinmux = <PINMUX_GPIO146__FUNC_GPIO146>;
			slew-rate = <1>;
			output-low;
		};
	};
	camera_pins_cam3_pnd_1: cam3@3 {
		pins_cmd_dat {
			pinmux = <PINMUX_GPIO146__FUNC_GPIO146>;
			slew-rate = <1>;
			output-high;
		};
	};
	camera_pins_cam4_rst_0: cam4@0 {
		pins_cmd_dat {
			pinmux = <PINMUX_GPIO146__FUNC_GPIO146>;
			slew-rate = <1>;
			output-low;
		};
	};
	camera_pins_cam4_rst_1: cam4@1 {
		pins_cmd_dat {
			pinmux = <PINMUX_GPIO146__FUNC_GPIO146>;
			slew-rate = <1>;
			output-high;
		};
	};
	camera_pins_cam4_pnd_0: cam4@2 {
		pins_cmd_dat {
			pinmux = <PINMUX_GPIO146__FUNC_GPIO146>;
			slew-rate = <1>;
			output-low;
		};
	};
	camera_pins_cam4_pnd_1: cam4@3 {
		pins_cmd_dat {
			pinmux = <PINMUX_GPIO146__FUNC_GPIO146>;
			slew-rate = <1>;
			output-high;
		};
	};
	camera_pins_cam0_vcamd_0: cam0@vcam0 {
		pins_cmd_dat {
			pinmux = <PINMUX_GPIO146__FUNC_GPIO146>;
			slew-rate = <1>;
			output-low;
		};
	};
	camera_pins_cam0_vcamd_1: cam0@vcam1 {
		pins_cmd_dat {
			pinmux = <PINMUX_GPIO146__FUNC_GPIO146>;
			slew-rate = <1>;
			output-high;
		};
	};
	camera_pins_cam0_vcama_0: cam0@vcam2 {
		pins_cmd_dat {
			pinmux = <PINMUX_GPIO146__FUNC_GPIO146>;
			slew-rate = <1>;
			output-low;
		};
	};
	camera_pins_cam0_vcama_1: cam0@vcam3 {
		pins_cmd_dat {
			pinmux = <PINMUX_GPIO146__FUNC_GPIO146>;
			slew-rate = <1>;
			output-high;
		};
	};
	camera_pins_cam1_vcamd_0: cam1@vcam0 {
		pins_cmd_dat {
			pinmux = <PINMUX_GPIO146__FUNC_GPIO146>;
			slew-rate = <1>;
			output-low;
		};
	};
	camera_pins_cam1_vcamd_1: cam1@vcam1 {
		pins_cmd_dat {
			pinmux = <PINMUX_GPIO146__FUNC_GPIO146>;
			slew-rate = <1>;
			output-high;
		};
	};
	camera_pins_cam1_vcama_0: cam1@vcam2 {
		pins_cmd_dat {
			pinmux = <PINMUX_GPIO146__FUNC_GPIO146>;
			slew-rate = <1>;
			output-low;
		};
	};
	camera_pins_cam1_vcama_1: cam1@vcam3 {
		pins_cmd_dat {
			pinmux = <PINMUX_GPIO146__FUNC_GPIO146>;
			slew-rate = <1>;
			output-high;
		};
	};
	camera_pins_cam2_vcamd_0: cam2@vcam0 {
		pins_cmd_dat {
			pinmux = <PINMUX_GPIO146__FUNC_GPIO146>;
			slew-rate = <1>;
			output-low;
		};
	};
	camera_pins_cam2_vcamd_1: cam2@vcam1 {
		pins_cmd_dat {
			pinmux = <PINMUX_GPIO146__FUNC_GPIO146>;
			slew-rate = <1>;
			output-high;
		};
	};
	camera_pins_cam2_vcama_0: cam2@vcam2 {
		pins_cmd_dat {
			pinmux = <PINMUX_GPIO146__FUNC_GPIO146>;
			slew-rate = <1>;
			output-low;
		};
	};
	camera_pins_cam2_vcama_1: cam2@vcam3 {
		pins_cmd_dat {
			pinmux = <PINMUX_GPIO146__FUNC_GPIO146>;
			slew-rate = <1>;
			output-high;
		};
	};
	camera_pins_cam3_vcamd_0: cam3@vcam0 {
		pins_cmd_dat {
			pinmux = <PINMUX_GPIO146__FUNC_GPIO146>;
			slew-rate = <1>;
			output-low;
		};
	};
	camera_pins_cam3_vcamd_1: cam3@vcam1 {
		pins_cmd_dat {
			pinmux = <PINMUX_GPIO146__FUNC_GPIO146>;
			slew-rate = <1>;
			output-high;
		};
	};
	camera_pins_cam3_vcama_0: cam3@vcam2 {
		pins_cmd_dat {
			pinmux = <PINMUX_GPIO146__FUNC_GPIO146>;
			slew-rate = <1>;
			output-low;
		};
	};
	camera_pins_cam3_vcama_1: cam3@vcam3 {
		pins_cmd_dat {
			pinmux = <PINMUX_GPIO146__FUNC_GPIO146>;
			slew-rate = <1>;
			output-high;
		};
	};
	camera_pins_cam4_vcamd_0: cam4@vcam0 {
		pins_cmd_dat {
			pinmux = <PINMUX_GPIO146__FUNC_GPIO146>;
			slew-rate = <1>;
			output-low;
		};
	};
	camera_pins_cam4_vcamd_1: cam4@vcam1 {
		pins_cmd_dat {
			pinmux = <PINMUX_GPIO146__FUNC_GPIO146>;
			slew-rate = <1>;
			output-high;
		};
	};
	camera_pins_cam4_vcama_0: cam4@vcam2 {
		pins_cmd_dat {
			pinmux = <PINMUX_GPIO146__FUNC_GPIO146>;
			slew-rate = <1>;
			output-low;
		};
	};
	camera_pins_cam4_vcama_1: cam4@vcam3 {
		pins_cmd_dat {
			pinmux = <PINMUX_GPIO146__FUNC_GPIO146>;
			slew-rate = <1>;
			output-high;
		};
	};
	camera_pins_cam0_mclk_off: camera_pins_cam0_mclk_off {
		pins_cmd_dat {
			pinmux = <PINMUX_GPIO149__FUNC_GPIO149>;
			drive-strength = <1>;
		};
	};
	camera_pins_cam0_mclk_2ma: camera_pins_cam0_mclk_2ma {
		pins_cmd_dat {
			pinmux = <PINMUX_GPIO149__FUNC_CMMCLK0>;
			drive-strength = <0>;
		};
	};
	camera_pins_cam0_mclk_4ma: camera_pins_cam0_mclk_4ma {
		pins_cmd_dat {
			pinmux = <PINMUX_GPIO149__FUNC_CMMCLK0>;
			drive-strength = <1>;
		};
	};
	camera_pins_cam0_mclk_6ma: camera_pins_cam0_mclk_6ma {
		pins_cmd_dat {
			pinmux = <PINMUX_GPIO149__FUNC_CMMCLK0>;
			drive-strength = <2>;
		};
	};
	camera_pins_cam0_mclk_8ma: camera_pins_cam0_mclk_8ma {
		pins_cmd_dat {
			pinmux = <PINMUX_GPIO149__FUNC_CMMCLK0>;
			drive-strength = <3>;
		};
	};
	camera_pins_cam1_mclk_off: camera_pins_cam1_mclk_off {
		pins_cmd_dat {
			pinmux = <PINMUX_GPIO137__FUNC_GPIO137>;
			drive-strength = <1>;
		};
	};
	camera_pins_cam1_mclk_2ma: camera_pins_cam1_mclk_2ma {
		pins_cmd_dat {
			pinmux = <PINMUX_GPIO137__FUNC_CMMCLK4>;
			drive-strength = <0>;
		};
	};
	camera_pins_cam1_mclk_4ma: camera_pins_cam1_mclk_4ma {
		pins_cmd_dat {
			pinmux = <PINMUX_GPIO137__FUNC_CMMCLK4>;
			drive-strength = <1>;
		};
	};
	camera_pins_cam1_mclk_6ma: camera_pins_cam1_mclk_6ma {
		pins_cmd_dat {
			pinmux = <PINMUX_GPIO137__FUNC_CMMCLK4>;
			drive-strength = <2>;
		};
	};
	camera_pins_cam1_mclk_8ma: camera_pins_cam1_mclk_8ma {
		pins_cmd_dat {
			pinmux = <PINMUX_GPIO137__FUNC_CMMCLK4>;
			drive-strength = <3>;
		};
	};
	camera_pins_cam2_mclk_off: camera_pins_cam2_mclk_off {
		pins_cmd_dat {
			pinmux = <PINMUX_GPIO136__FUNC_GPIO136>;
			drive-strength = <1>;
		};
	};
	camera_pins_cam2_mclk_2ma: camera_pins_cam2_mclk_2ma {
		pins_cmd_dat {
			pinmux = <PINMUX_GPIO136__FUNC_CMMCLK3>;
			drive-strength = <0>;
		};
	};
	camera_pins_cam2_mclk_4ma: camera_pins_cam2_mclk_4ma {
		pins_cmd_dat {
			pinmux = <PINMUX_GPIO136__FUNC_CMMCLK3>;
			drive-strength = <1>;
		};
	};
	camera_pins_cam2_mclk_6ma: camera_pins_cam2_mclk_6ma {
		pins_cmd_dat {
			pinmux = <PINMUX_GPIO136__FUNC_CMMCLK3>;
			drive-strength = <2>;
		};
	};
	camera_pins_cam2_mclk_8ma: camera_pins_cam2_mclk_8ma {
		pins_cmd_dat {
			pinmux = <PINMUX_GPIO136__FUNC_CMMCLK3>;
			drive-strength = <3>;
		};
	};
	camera_pins_cam3_mclk_off: camera_pins_cam3_mclk_off {
		pins_cmd_dat {
			pinmux = <PINMUX_GPIO151__FUNC_GPIO151>;
			drive-strength = <1>;
		};
	};
	camera_pins_cam3_mclk_2ma: camera_pins_cam3_mclk_2ma {
		pins_cmd_dat {
			pinmux = <PINMUX_GPIO151__FUNC_CMMCLK2>;
			drive-strength = <0>;
		};
	};
	camera_pins_cam3_mclk_4ma: camera_pins_cam3_mclk_4ma {
		pins_cmd_dat {
			pinmux = <PINMUX_GPIO151__FUNC_CMMCLK2>;
			drive-strength = <1>;
		};
	};
	camera_pins_cam3_mclk_6ma: camera_pins_cam3_mclk_6ma {
		pins_cmd_dat {
			pinmux = <PINMUX_GPIO151__FUNC_CMMCLK2>;
			drive-strength = <2>;
		};
	};
	camera_pins_cam3_mclk_8ma: camera_pins_cam3_mclk_8ma {
		pins_cmd_dat {
			pinmux = <PINMUX_GPIO151__FUNC_CMMCLK2>;
			drive-strength = <3>;
		};
	};
	camera_pins_cam4_mclk_off: camera_pins_cam4_mclk_off {
		pins_cmd_dat {
			pinmux = <PINMUX_GPIO151__FUNC_GPIO151>;
			drive-strength = <1>;
		};
	};
	camera_pins_cam4_mclk_2ma: camera_pins_cam4_mclk_2ma {
		pins_cmd_dat {
			pinmux = <PINMUX_GPIO151__FUNC_CMMCLK2>;
			drive-strength = <0>;
		};
	};
	camera_pins_cam4_mclk_4ma: camera_pins_cam4_mclk_4ma {
		pins_cmd_dat {
			pinmux = <PINMUX_GPIO151__FUNC_CMMCLK2>;
			drive-strength = <1>;
		};
	};
	camera_pins_cam4_mclk_6ma: camera_pins_cam4_mclk_6ma {
		pins_cmd_dat {
			pinmux = <PINMUX_GPIO151__FUNC_CMMCLK2>;
			drive-strength = <2>;
		};
	};
	camera_pins_cam4_mclk_8ma: camera_pins_cam4_mclk_8ma {
		pins_cmd_dat {
			pinmux = <PINMUX_GPIO151__FUNC_CMMCLK2>;
			drive-strength = <3>;
		};
	};
	camera_pins_default: camdefault {
	};
};
&kd_camera_hw1 {
	cam0_vcamio-supply = <&mt_pmic_vcamio_ldo_reg>;
	cam1_vcamio-supply = <&mt_pmic_vcamio_ldo_reg>;
	cam2_vcamio-supply = <&mt_pmic_vtp_ldo_reg>;
	cam3_vcamio-supply = <&mt_pmic_vcamio_ldo_reg>;

	cam0_vcamd-supply = <&wl2866d1_dvdd1>;
	cam0_vcama-supply = <&wl2866d1_avdd1>;
	cam1_vcamd-supply = <&wl2866d2_dvdd1>;
	cam1_vcama-supply = <&wl2866d2_avdd1>;
	cam2_vcama-supply = <&wl2866d2_avdd1>;
	cam3_vcamd-supply = <&wl2866d2_dvdd2>;
	cam3_vcama-supply = <&wl2866d2_avdd2>;

	cam0_enable_sensor = "ov64b40sunny_mipi_raw";
	cam1_enable_sensor = "ov16a1qofilm_mipi_raw";
	cam2_enable_sensor = "gc02m1sunny_mipi_raw";
	cam3_enable_sensor = "imx355sunny_mipi_raw";

	pinctrl-names = "default",
			"cam0_rst0", "cam0_rst1",
			"cam0_pnd0", "cam0_pnd1",
			"cam1_rst0", "cam1_rst1",
			"cam1_pnd0", "cam1_pnd1",
			"cam2_rst0", "cam2_rst1",
			"cam2_pnd0", "cam2_pnd1",
			"cam3_rst0", "cam3_rst1",
			"cam3_pnd0", "cam3_pnd1",
			"cam4_rst0", "cam4_rst1",
			"cam4_pnd0", "cam4_pnd1",
			"cam0_ldo_vcamd_0", "cam0_ldo_vcamd_1",
			"cam0_ldo_vcama_0", "cam0_ldo_vcama_1",
			"cam1_ldo_vcamd_0", "cam1_ldo_vcamd_1",
			"cam1_ldo_vcama_0", "cam1_ldo_vcama_1",
			"cam2_ldo_vcamd_0", "cam2_ldo_vcamd_1",
			"cam2_ldo_vcama_0", "cam2_ldo_vcama_1",
			"cam3_ldo_vcamd_0", "cam3_ldo_vcamd_1",
			"cam3_ldo_vcama_0", "cam3_ldo_vcama_1",
			"cam4_ldo_vcamd_0", "cam4_ldo_vcamd_1",
			"cam4_ldo_vcama_0", "cam4_ldo_vcama_1",
			"cam0_mclk_off",
			"cam0_mclk_2mA", "cam0_mclk_4mA",
			"cam0_mclk_6mA", "cam0_mclk_8mA",
			"cam1_mclk_off",
			"cam1_mclk_2mA", "cam1_mclk_4mA",
			"cam1_mclk_6mA", "cam1_mclk_8mA",
			"cam2_mclk_off",
			"cam2_mclk_2mA", "cam2_mclk_4mA",
			"cam2_mclk_6mA", "cam2_mclk_8mA",
			"cam3_mclk_off",
			"cam3_mclk_2mA", "cam3_mclk_4mA",
			"cam3_mclk_6mA", "cam3_mclk_8mA",
			"cam4_mclk_off",
			"cam4_mclk_2mA", "cam4_mclk_4mA",
			"cam4_mclk_6mA", "cam4_mclk_8mA";
	pinctrl-0 = <&camera_pins_default>;
	pinctrl-1 = <&camera_pins_cam0_rst_0>;
	pinctrl-2 = <&camera_pins_cam0_rst_1>;
	pinctrl-3 = <&camera_pins_cam0_pnd_0>;
	pinctrl-4 = <&camera_pins_cam0_pnd_1>;
	pinctrl-5 = <&camera_pins_cam1_rst_0>;
	pinctrl-6 = <&camera_pins_cam1_rst_1>;
	pinctrl-7 = <&camera_pins_cam1_pnd_0>;
	pinctrl-8 = <&camera_pins_cam1_pnd_1>;
	pinctrl-9 = <&camera_pins_cam2_rst_0>;
	pinctrl-10 = <&camera_pins_cam2_rst_1>;
	pinctrl-11 = <&camera_pins_cam2_pnd_0>;
	pinctrl-12 = <&camera_pins_cam2_pnd_1>;
	pinctrl-13 = <&camera_pins_cam3_rst_0>;
	pinctrl-14 = <&camera_pins_cam3_rst_1>;
	pinctrl-15 = <&camera_pins_cam3_pnd_0>;
	pinctrl-16 = <&camera_pins_cam3_pnd_1>;
	pinctrl-17 = <&camera_pins_cam4_rst_0>;
	pinctrl-18 = <&camera_pins_cam4_rst_1>;
	pinctrl-19 = <&camera_pins_cam4_pnd_0>;
	pinctrl-20 = <&camera_pins_cam4_pnd_1>;
	pinctrl-21 = <&camera_pins_cam0_vcamd_0>;
	pinctrl-22 = <&camera_pins_cam0_vcamd_1>;
	pinctrl-23 = <&camera_pins_cam0_vcama_0>;
	pinctrl-24 = <&camera_pins_cam0_vcama_1>;
	pinctrl-25 = <&camera_pins_cam1_vcamd_0>;
	pinctrl-26 = <&camera_pins_cam1_vcamd_1>;
	pinctrl-27 = <&camera_pins_cam1_vcama_0>;
	pinctrl-28 = <&camera_pins_cam1_vcama_1>;
	pinctrl-29 = <&camera_pins_cam2_vcamd_0>;
	pinctrl-30 = <&camera_pins_cam2_vcamd_1>;
	pinctrl-31 = <&camera_pins_cam2_vcama_0>;
	pinctrl-32 = <&camera_pins_cam2_vcama_1>;
	pinctrl-33 = <&camera_pins_cam3_vcamd_0>;
	pinctrl-34 = <&camera_pins_cam3_vcamd_1>;
	pinctrl-35 = <&camera_pins_cam3_vcama_0>;
	pinctrl-36 = <&camera_pins_cam3_vcama_1>;
	pinctrl-37 = <&camera_pins_cam4_vcamd_0>;
	pinctrl-38 = <&camera_pins_cam4_vcamd_1>;
	pinctrl-39 = <&camera_pins_cam4_vcama_0>;
	pinctrl-40 = <&camera_pins_cam4_vcama_1>;
	pinctrl-41 = <&camera_pins_cam0_mclk_off>;
	pinctrl-42 = <&camera_pins_cam0_mclk_2ma>;
	pinctrl-43 = <&camera_pins_cam0_mclk_4ma>;
	pinctrl-44 = <&camera_pins_cam0_mclk_6ma>;
	pinctrl-45 = <&camera_pins_cam0_mclk_8ma>;
	pinctrl-46 = <&camera_pins_cam1_mclk_off>;
	pinctrl-47 = <&camera_pins_cam1_mclk_2ma>;
	pinctrl-48 = <&camera_pins_cam1_mclk_4ma>;
	pinctrl-49 = <&camera_pins_cam1_mclk_6ma>;
	pinctrl-50 = <&camera_pins_cam1_mclk_8ma>;
	pinctrl-51 = <&camera_pins_cam2_mclk_off>;
	pinctrl-52 = <&camera_pins_cam2_mclk_2ma>;
	pinctrl-53 = <&camera_pins_cam2_mclk_4ma>;
	pinctrl-54 = <&camera_pins_cam2_mclk_6ma>;
	pinctrl-55 = <&camera_pins_cam2_mclk_8ma>;
	pinctrl-56 = <&camera_pins_cam3_mclk_off>;
	pinctrl-57 = <&camera_pins_cam3_mclk_2ma>;
	pinctrl-58 = <&camera_pins_cam3_mclk_4ma>;
	pinctrl-59 = <&camera_pins_cam3_mclk_6ma>;
	pinctrl-60 = <&camera_pins_cam3_mclk_8ma>;
	pinctrl-61 = <&camera_pins_cam4_mclk_off>;
	pinctrl-62 = <&camera_pins_cam4_mclk_2ma>;
	pinctrl-63 = <&camera_pins_cam4_mclk_4ma>;
	pinctrl-64 = <&camera_pins_cam4_mclk_6ma>;
	pinctrl-65 = <&camera_pins_cam4_mclk_8ma>;

	status = "okay";
};
/* CAMERA GPIO end */

/* CAMERA EEPROM */
/* 0 main, 1 sub, 2 main2, 3 sub2, 4 main3 */
&i2c2 {
	mtk_camera_eeprom0: eeprom@51 {
		/* 原厂 mediatek,camera_eeprom（相机 OTP）；容量可用 size 覆盖 */
		compatible = "atmel,24c16";
		reg = <0x51>;
		status = "okay";
	};
};
&i2c4 {
	mtk_camera_eeprom1: eeprom@51 {
		/* 原厂 mediatek,camera_eeprom（相机 OTP）；容量可用 size 覆盖 */
		compatible = "atmel,24c16";
		reg = <0x51>;
		status = "okay";
	};

	mtk_camera_eeprom4: eeprom@51 {
		/* 原厂 mediatek,camera_eeprom（相机 OTP）；容量可用 size 覆盖 */
		compatible = "atmel,24c16";
		reg = <0x51>;
		status = "okay";
	};

};
&i2c8 {
	mtk_camera_eeprom2: eeprom@52 {
		/* 原厂 mediatek,camera_eeprom（相机 OTP）；容量可用 size 覆盖 */
		compatible = "atmel,24c16";
		reg = <0x52>;
		status = "okay";
	};

	mtk_camera_eeprom3: eeprom@50 {
		/* 原厂 mediatek,camera_eeprom（相机 OTP）；容量可用 size 覆盖 */
		compatible = "atmel,24c16";
		reg = <0x50>;
		status = "okay";
	};
};
/* CAMERA EEPROM end */

/* CAMERA AF start */
&camera_af_hw_node {
	vcamwaf-supply = <&wl2866d1_avdd2>;
	status = "okay";
};
/* CAMERA AF end */


/* ══════ 板级数据：ares-mt6893.dtsi — ares 归属配置 (lineage-23.2 上传) ══════ */
/*
this file is only for attribution of ares
*/

&odm {
	thermal_message: thermal-message {
		board-sensor = "VIRTUAL-SENSOR";
	};
};

/*TOUCH begin*/
/*mt_pmic_vs1_buck_reg*/
&regulators {
	touch_avdd_i2c_vreg: touch_avdd_i2c_vreg {
		compatible = "regulator-fixed";
		regulator-min-microvolt = <1800000>;
		regulator-max-microvolt = <1800000>;
		regulator-name = "touch_avdd_i2c_vreg";
		enable-active-high;
		gpio = <&pio 27 0>;
	};
};

&pio {
	ts_reset_active: ts_reset_active {
		pins_cmd_dat {
			pinmux = <PINMUX_GPIO20__FUNC_GPIO20>;
			output-high;
		};
	 };

	ts_int_active: ts_int_active {
		pins_cmd_dat {
			pinmux = <PINMUX_GPIO21__FUNC_GPIO21>;
			input-enable;
		};
	 };

	ts_reset_suspend: ts_reset_suspend {
		pins_cmd_dat {
			pinmux = <PINMUX_GPIO20__FUNC_GPIO20>;
			slew-rate = <1>;
			bias-pull-down;
		};
	 };

	ts_int_suspend: ts_int_suspend {
		pins_cmd_dat {
			pinmux = <PINMUX_GPIO21__FUNC_GPIO21>;
			slew-rate = <1>;
			bias-pull-down;
		};
	 };

	ts_release: ts_release {
		pins_cmd0_dat {
			pinmux = <PINMUX_GPIO20__FUNC_GPIO20>;
			slew-rate = <1>;
			bias-pull-up;
		};
		pins_cmd1_dat {
			pinmux = <PINMUX_GPIO21__FUNC_GPIO21>;
			slew-rate = <1>;
			bias-disable;
		};
	};

	ts_spi_mode: ts_spimode {
		pins_cmd_dat {
			pinmux = <PINMUX_GPIO0__FUNC_SPI6_CLK>,
					 <PINMUX_GPIO1__FUNC_SPI6_CSB>,
					 <PINMUX_GPIO2__FUNC_SPI6_MI>,
					 <PINMUX_GPIO3__FUNC_SPI6_MO>;
			drive-strength = <2>;
		};
	 };
};

&mt_pmic_vmch_ldo_reg {
	regulator-boot-on;
	regulator-min-microvolt = <3000000>;
	regulator-max-microvolt = <3300000>;
};

&spi6 {
	status = "okay";
	#address-cells = <1>;
	#size-cells = <0>;
	focaltech@0 {
		compatible = "focaltech,fts";
			#if ARES_TOUCH_VARIANT == ARES_TOUCH_FT3658U
				status = "okay";
			#else
				status = "disabled";
			#endif
		reg = <0x0>;
		spi-max-frequency = <6000000>;
		interrupt-parent = <&pio>;
		interrupts = <21 IRQ_TYPE_EDGE_FALLING>;
		pinctrl-names = "pmx_ts_active", "pmx_ts_suspend", "pmx_ts_release",
						"ft3658u_spi_mode";
		pinctrl-0 = <&ts_int_active &ts_reset_active>;
		pinctrl-1 = <&ts_int_suspend &ts_reset_suspend>;
		pinctrl-2 = <&ts_release>;
		pinctrl-3 = <&ts_spi_mode>;
		vdd-supply = <&mt_pmic_vmch_ldo_reg>;
		vcc_i2c-supply = <&touch_avdd_i2c_vreg>;
		focaltech,reset-gpio = <&pio 20 0x00>;
		focaltech,irq-gpio = <&pio 21 0x2008>;
		focaltech,max-touch-number = <10>;
		focaltech,display-coords = <0 0 17280 38400>;
		focaltech,open-min = <4000>;
		focaltech,touch-range-array = <1 5 10 15 20>;
		focaltech,touch-def-array = <3 3 3 3>;
		focaltech,touch-expert-array = <10 10 10 10
						20 20 15 10
						20 20 20 10>;
	};
};
/*TOUCH end*/

//WL2866D start
&i2c4 {
	wl2866d1_pm:willsemi,ldo@28 {
		compatible = "willsemi,wl2866d1";
		reg = <0x28>;/*slave address*/
		index = <0>;

		wl2866d1_dvdd1:on,wl2866d1@0{
			offset = /bits/ 16 <0x0000>;
			regulator-name ="wl2866d-dvdd1";
			regulator-min-microvolt = <600000>;
			regulator-max-microvolt = <1800000>;
			min-dropout-voltage = <80000>;
			iout_ua = <500000>;
			init-voltage = <1050000>;
		};

		wl2866d1_dvdd2:on,wl2866d1@1{
			offset = /bits/ 16 <0x0001>;
			regulator-name ="wl2866d-dvdd2";
			regulator-min-microvolt = <600000>;
			regulator-max-microvolt = <1800000>;
			min-dropout-voltage = <80000>;
			iout_ua = <500000>;
			init-voltage = <1260000>;
		};

		wl2866d1_avdd1:on,wl2866d1@2{
			offset = /bits/ 16 <0x0002>;
			regulator-name ="wl2866d-avdd1";
			regulator-min-microvolt = <1200000>;
			regulator-max-microvolt = <4300000>;
			min-dropout-voltage = <90000>;
			iout_ua = <300000>;
			init-voltage = <2800000>;
		};

		wl2866d1_avdd2:on,wl2866d1@3{
			offset = /bits/ 16 <0x0003>;
			regulator-name ="wl2866d-avdd2";
			regulator-min-microvolt = <1200000>;
			regulator-max-microvolt = <4300000>;
			min-dropout-voltage = <90000>;
			iout_ua = <300000>;
			init-voltage = <2800000>;
		};
	};
};

&odm {
	testing-mode {
		compatible = "modem,testing-mode";
		status-gpio = <&pio 56 0>, <&pio 194 0>;
		debounce-time = <30>;
		pinctrl-names = "default";
		pinctrl-0 = <&test_mode_irq56 &test_mode_irq194>;
	};
};
&pio {
	test_mode_irq56: test_mode_irq56 {
                pins_cmd_dat {
			pinmux = <PINMUX_GPIO56__FUNC_GPIO56>;
			drive-strength = <2>;
			bias-disable;
			input-enable;
		};
	};
    test_mode_irq194: test_mode_irq194 {
        	pins_cmd_dat {
			pinmux = <PINMUX_GPIO194__FUNC_GPIO194>;
			drive-strength = <2>;
			bias-disable;
			input-enable;
		};
    };
};

&i2c7 {
	wl2866d2_pm:willsemi,ldo@28 {
		compatible = "willsemi,wl2866d2";
		reg = <0x28>;/*slave address*/
		index = <1>;

		wl2866d2_dvdd1:on,wl2866d2@0{
			offset = /bits/ 16 <0x0000>;
			regulator-name ="wl2866d-dvdd1";
			regulator-min-microvolt = <600000>;
			regulator-max-microvolt = <1800000>;
			min-dropout-voltage = <80000>;
			iout_ua = <500000>;
			init-voltage = <1050000>;
		};

		wl2866d2_dvdd2:on,wl2866d2@1{
			offset = /bits/ 16 <0x0001>;
			regulator-name ="wl2866d-dvdd2";
			regulator-min-microvolt = <600000>;
			regulator-max-microvolt = <1800000>;
			min-dropout-voltage = <80000>;
			iout_ua = <500000>;
			init-voltage = <1200000>;
		};

		wl2866d2_avdd1:on,wl2866d2@2{
			offset = /bits/ 16 <0x0002>;
			regulator-name ="wl2866d-avdd1";
			regulator-min-microvolt = <1200000>;
			regulator-max-microvolt = <4300000>;
			min-dropout-voltage = <90000>;
			iout_ua = <300000>;
			init-voltage = <2800000>;
		};

		wl2866d2_avdd2:on,wl2866d2@3{
			offset = /bits/ 16 <0x0003>;
			regulator-name ="wl2866d-avdd2";
			regulator-min-microvolt = <1200000>;
			regulator-max-microvolt = <4300000>;
			min-dropout-voltage = <90000>;
			iout_ua = <300000>;
			init-voltage = <2700000>;
		};
	};
};
//WL2866D end

&mt6315_6_regulator {
	interrupts = <18 IRQ_TYPE_LEVEL_HIGH>;
};

&mt6315_3_regulator {
	interrupts = <23 IRQ_TYPE_LEVEL_HIGH>;
};

&tboard_thermistor6 {
        thermal_rename = "xx_therm";
};

&lk_charger {
	max_charger_voltage = <14500000>;

	/* charging current */
	usb_charger_current = <500000>;
	ac_charger_current = <1500000>;
	ac_charger_input_current = <1500000>;
	non_std_ac_charger_current = <1000000>;
	charging_host_charger_current = <1500000>;
	ta_ac_charger_current = <1500000>;
	pd_charger_current = <1500000>;

	/* battery temperature protection */
	temp_t4_threshold = <60>;
	temp_t3_threshold = <0>;
	temp_t1_threshold = <(-10)>;
};

&charger {
	algorithm_name = "SwitchCharging2";

	battery_cv = <4460000>;

	/* vote */
	enable_vote;
	enable_cv_step;
	enable_cv_aging;
	step_a = <4200000>;
	step_b = <4300000>;
	step_c = <4400000>;
	current_a = <8937000>;
	current_b = <7447500>;
	current_c = <5958000>;
	current_max = <12400000>;
	step_hy_down_a = <150000>;
	step_hy_down_b = <150000>;
	step_hy_down_c = <150000>;
	step_a_aging = <4150000>;
	step_b_aging = <4300000>;
	step_c_aging = <4400000>;
	current_step_aging = <200000>;
	current_max_aging = <12400000>;

	/* ffc */
	enable_ffc;
	non_ffc_ieoc = <150000>;
	non_ffc_cv = <4450000>;
	ffc_ieoc = <700000>;
	ffc_ieoc_b = <850000>;
	ffc_cv = <4490000>;

	enable_sw_jeita;
	/* sw jeita */
	jeita_temp_above_t4_cv = <4100000>;
	jeita_temp_t3_to_t4_cv = <4100000>;
	jeita_temp_t2_to_t3_cv = <4450000>;
	jeita_temp_t1p5_to_t2_cv = <4450000>;
	jeita_temp_t1_to_t1p5_cv = <4450000>;
	jeita_temp_t0_to_t1_cv = <4450000>;
	jeita_temp_tn1_to_t0_cv_a = <4200000>;
	jeita_temp_tn1_to_t0_cv_b = <4450000>;
	jeita_temp_below_t0_cv = <4200000>;
	temp_t4_thres = <60>;
	temp_t4_thres_minus_x_degree = <58>;
	temp_t3_thres = <48>;
	temp_t3_thres_minus_x_degree = <47>;
	temp_t2_thres = <15>;
	temp_t2_thres_plus_x_degree = <17>;
	temp_t1p5_thres = <10>;
	temp_t1p5_thres_plus_x_degree = <11>;
	temp_t1_thres = <5>;
	temp_t1_thres_plus_x_degree = <6>;
	temp_t0_thres = <0>;
	temp_t0_thres_plus_x_degree = <1>;
	temp_tn1_thres = <(-10)>;
	temp_tn1_thres_plus_x_degree = <(-9)>;
	temp_neg_10_thres = <(-10)>;
	temp_t3_to_t4_fcc = <2482500>;
	temp_t2_to_t3_fcc = <12400000>;
	temp_t1p5_to_t2_fcc = <5958000>;
	temp_t1_to_t1p5_fcc = <3475500>;
	temp_t0_to_t1_fcc = <2482500>;
	temp_tn1_to_t0_fcc_a = <1000000>;
	temp_tn1_to_t0_fcc_b = <744750>;
	/* battery temperature protection */
	enable_min_charge_temp;
	min_charge_temp = <0>;
	min_charge_temp_plus_x_degree = <2>;
	max_charge_temp = <60>;
	max_charge_temp_minus_x_degree = <58>;

	qcom,thermal-mitigation-dcp
		= <1600000 1600000 1600000 1600000 1600000 1600000 1600000
		1600000 1600000 1600000 1600000 1600000 1500000 1400000
		1200000 1000000>;
	qcom,thermal-mitigation-qc3p5
		= <4500000 4200000 4000000 3800000 3600000 3400000 3200000
		3100000 3000000 2800000 2600000 2400000 2200000 2000000
		1000000 700000>;
	qcom,thermal-mitigation-qc3
		= <3600000 3600000 3600000 3500000 3400000 3300000 3200000
		3100000 3000000 2800000 2600000 2400000 2200000 2000000
		1000000 700000>;
	qcom,thermal-mitigation-qc3-classb
		= <5100000 4700000 4300000 4000000 3600000 3500000 3400000
		3400000 3400000 3200000 2500000 2200000 2000000 1300000
		1000000 700000>;
	qcom,thermal-mitigation-qc2
		= <1500000 1500000 1500000 1500000 1500000 1500000 1400000
		1300000 1200000 1100000 1000000 900000 800000 700000
		600000 500000>;
	qcom,thermal-mitigation-pd-base
		= <12400000 11000000 9700000 8800000 8000000 7500000 7000000
		6800000 6500000 6000000 5000000 4000000 3000000 2600000
		1000000 500000>;

	/* enable_pe_plus; */
	/* enable_pe_2; */
	bc12_charger = <1>;

	charging_host_charger_current = <1500000>;
	/* common */
	max_charger_voltage = <14500000>;

	/* xiaomi pps */
	xm_pps_single_charger_input_current = <3000000>;
	xm_pps_single_charger_current = <6000000>;
	xm_pps_dual_charger_input_current = <3000000>;
	xm_pps_dual_charger_chg1_current = <500000>;
	xm_pps_dual_charger_chg2_current = <2500000>;
	xm_pps_max_vbus = <12000000>;
	xm_pps_max_ibus = <3000000>;
	xm_pps_single_charger_current_non_verified_pps = <4800000>;

	/* PD */
	pd_vbus_upper_bound = <9000000>;
	ac_charger_input_current = <1500000>;
	/* float charger */
	non_std_ac_charger_current = <1000000>;
	/* default ac charger charge current */
	ac_charger_current = <2000000>;

	use_xmusb350_do_apsd;
};

&mt6360_pmu {
	chg {
		cv = <4450000>;			/* uA */
		ieoc = <200000>;		/* uA */
		ircmp_resistor = <0>;		/* uohm */
		ircmp_vclamp = <0>;		/* uV */
		en_te = <1>;
		en_eoc = <1>;
	};
	core {
		sda_sizesel = <3>;
		sda_drvsrsel = <1>;
	};
};

&bat_gm30 {
	DISABLE_MTKBATTERY = <(1)>;
	use-ti-gauge;
};

&pio {
	/* bq25970-master */
	bq2597x_master_int_default: bq2597x_master_int_default {
		pins_cmd_dat {
			pinmux = <PINMUX_GPIO16__FUNC_GPIO16>;
			slew-rate = <0>;
			bias-pull-up = <11>;
		};
	};

	bq2597x_master_int_suspend: bq2597x_master_int_suspend {
		pins_cmd_dat {
			pinmux = <PINMUX_GPIO16__FUNC_GPIO16>;
			slew-rate = <0>;
			bias-pull-up = <11>;
		};
	};

	/* bq25970-slave */
	bq2597x_slave_int_default: bq2597x_slave_int_default {
		pins_cmd_dat {
			pinmux = <PINMUX_GPIO19__FUNC_GPIO19>;
			slew-rate = <0>;
			bias-pull-up = <11>;
		};
	};

	bq2597x_slave_int_suspend: bq2597x_slave_int_suspend {
		pins_cmd_dat {
			pinmux = <PINMUX_GPIO19__FUNC_GPIO19>;
			slew-rate = <0>;
			bias-pull-up = <11>;
		};
	};

	/* xmusb350 */
	xmusb350_int_normal: xmusb350_int_normal {
		pins_cmd_dat {
			pinmux = <PINMUX_GPIO110__FUNC_GPIO110>;
			slew-rate = <0>;
			bias-pull-up = <11>;
			input-enable;
		};
	};

	xmusb350_int_isp: xmusb350_int_isp {
		pins_cmd_dat {
			pinmux = <PINMUX_GPIO110__FUNC_GPIO110>;
			slew-rate = <0>;
			bias-pull-up = <11>;
			input-enable;
		};
	};

	xmusb350_rst_normal: xmusb350_rst_normal {
		pins_cmd_dat {
			pinmux = <PINMUX_GPIO28__FUNC_GPIO28>;
			slew-rate = <1>;
			bias-disable;
			output-low;
		};
	};

	xmusb350_rst_isp: xmusb350_rst_isp {
		pins_cmd_dat {
			pinmux = <PINMUX_GPIO28__FUNC_GPIO28>;
			slew-rate = <1>;
			bias-disable;
			output-low;
		};
	};

	xmusb350_sda_normal: xmusb350_sda_normal {
		pins_cmd_dat {
			pinmux = <PINMUX_GPIO205__FUNC_SDA0>;
			slew-rate = <0>;
			bias-pull-up = <11>;
			input-enable;
		};
	};

	xmusb350_sda_isp: xmusb350_sda_isp {
		pins_cmd_dat {
			pinmux = <PINMUX_GPIO205__FUNC_GPIO205>;
			slew-rate = <1>;
			bias-disable;
			output-low;
		};
	};

	xmusb350_scl_normal: xmusb350_scl_normal {
		pins_cmd_dat {
			pinmux = <PINMUX_GPIO204__FUNC_SCL0>;
			slew-rate = <0>;
			bias-pull-up = <11>;
			input-enable;
		};
	};

	xmusb350_scl_isp: xmusb350_scl_isp {
		pins_cmd_dat {
			pinmux = <PINMUX_GPIO204__FUNC_GPIO204>;
			slew-rate = <1>;
			bias-disable;
			output-low;
		};
	};
};

&i2c0 {
	/* before p1.1 lot1 */
	clock-frequency = <100000>;
	bq27z561_i2c0@55 {
		compatible = "ti,bq27z561_i2c0";
		reg = <0x55>;
		bq,ignore-digest-debug;
		bq,charge-full-design = <5065000>;
		bq,recharge-voltage   = <4380>;
		bq,shutdown-delay-enable;
		bq,soc_decimal_rate = <
			0  38
			10 35
			20 33
			30 33
			40 33
			50 33
			60 33
			70 30
			80 25
			90 20
			95 10 >;
		bq,cold_thermal_seq = <
			1      0  100 1700
			2  (-300)   0 1000 >;
	};
	xmusb350-charger@35 {
		compatible = "xm,xmusb350-charger";
			reset-gpios = <&pio 28 0x00>;	/* xm,xmusb350_rst_gpio */
			irq-gpios = <&pio 110 0x00>;	/* interrupts = <110 ...> -> gpiod */
			sda-gpios = <&pio 205 0x00>;	/* xm,xmusb350_sda_gpio */
			scl-gpios = <&pio 204 0x00>;	/* xm,xmusb350_scl_gpio */
			therm-gpios = <&pio 29 0x00>;	/* mi,connect_therm */
		reg = <0x35>;
		interrupt-parent = <&pio>;
		interrupts = <110 IRQ_TYPE_EDGE_FALLING>;
		pinctrl-names = "xmusb350_normal", "xmusb350_isp";
		pinctrl-0 = <&xmusb350_rst_normal &xmusb350_sda_normal &xmusb350_scl_normal>;
		pinctrl-1 = <&xmusb350_rst_isp &xmusb350_sda_isp &xmusb350_scl_isp>;
		xm,xmusb350_rst_gpio = <&pio 28 0x00>;
		xm,xmusb350_sda_gpio = <&pio 205 0x00>;
		xm,xmusb350_scl_gpio = <&pio 204 0x00>;
		mi,connect_therm = <&pio 29 0x00>;

		charger_name = "secondary_chg";
		alias_name  = "xmusb350";
		en_bc12;
		en_hvdcp;
		en_intb;
		en_sleep;
	};
};

&i2c9 {
	clock-frequency = <400000>;
	/* after p1.1 lot1 */
	bq27z561_i2c9@55 {
		compatible = "ti,bq27z561_i2c9";
		reg = <0x55>;
		bq,ignore-digest-debug;
		bq,charge-full-design = <5065000>;
		bq,recharge-voltage   = <4380>;
		bq,shutdown-delay-enable;
		bq,soc_decimal_rate = <
			0  38
			10 35
			20 33
			30 33
			40 33
			50 33
			60 33
			70 30
			80 25
			90 20
			95 10 >;
		bq,cold_thermal_seq = <
			1      0  100 1700
			2  (-300)   0 1000 >;
	};
	bq2597x-master@65 {
		compatible = "ti,bq2597x-master";
		reg = <0x65>;
		interrupt-parent = <&pio>;
		interrupts = <16 IRQ_TYPE_EDGE_FALLING>;
		pinctrl-names = "bq2597x_master_irq";
		pinctrl-0 = <&bq2597x_master_int_default &bq2597x_master_int_suspend>;

		charger_name = "tertiary_chg";

		/*ti,bq2597x,bat-ovp-disable;*/
		ti,bq2597x,bat-ovp-alarm-disable;
		//ti,bq2597x,bat-ocp-disable;
		//ti,bq2597x,bat-ocp-alarm-disable;
		ti,bq2597x,bat-ucp-alarm-disable;
		ti,bq2597x,bat-ucp-disable;

		/*ti,bq2597x,bus-ovp-alarm-disable;
		ti,bq2597x,bus-ocp-disable;
		ti,bq2597x,bus-ocp-alarm-disable;*/
		ti,bq2597x,bat-therm-disable;
		ti,bq2597x,bus-therm-disable;
		ti,bq2597x,die-therm-disable;

		ti,bq2597x,bat-ovp-threshold = <4650>;
		ti,bq2597x,bat-ovp-alarm-threshold = <4625>;
		ti,bq2597x,bat-ocp-threshold = <7000>;
		ti,bq2597x,bat-ocp-alarm-threshold = <6000>;

		ti,bq2597x,bus-ovp-threshold = <12000>;
		ti,bq2597x,bus-ovp-alarm-threshold = <11000>;
		//ti,bq2597x,bus-ocp-threshold = <2200>;
		//ti,bq2597x,bus-ocp-alarm-threshold = <2000>;
		ti,bq2597x,bus-ocp-threshold = <4000>;
		ti,bq2597x,bus-ocp-alarm-threshold = <3500>;

		//ti,bq2597x,bat-ucp-alarm-threshold = <2000>;

		ti,bq2597x,bat-therm-threshold = <0x15>;/*4.1%*/
		ti,bq2597x,bus-therm-threshold = <0x15>;/*4.1%*/
		ti,bq2597x,die-therm-threshold = <145>;

		ti,bq2597x,ac-ovp-threshold = <14>;
		sc8551,ac-ovp-threshold = <13>;

		//ti,bq2597x,sense-resistor-mohm = <5>;
	};
};

&i2c11 {
	clock-frequency = <400000>;
	bq2597x-slave@66 {
		compatible = "ti,bq2597x-slave";
		reg = <0x66>;
		interrupt-parent = <&pio>;
		interrupts = <19 IRQ_TYPE_EDGE_FALLING>;
		pinctrl-names = "bq2597x_slave_irq";
		pinctrl-0 = <&bq2597x_slave_int_default &bq2597x_slave_int_suspend>;

		charger_name = "quaternary_chg";

		/*ti,bq2597x,bat-ovp-disable;*/
		ti,bq2597x,bat-ovp-alarm-disable;
		//ti,bq2597x,bat-ocp-disable;
		//ti,bq2597x,bat-ocp-alarm-disable;
		ti,bq2597x,bat-ucp-alarm-disable;
		ti,bq2597x,bat-ucp-disable;

		/*ti,bq2597x,bus-ovp-alarm-disable;
		ti,bq2597x,bus-ocp-disable;
		ti,bq2597x,bus-ocp-alarm-disable;*/
		ti,bq2597x,bat-therm-disable;
		ti,bq2597x,bus-therm-disable;
		ti,bq2597x,die-therm-disable;

		ti,bq2597x,bat-ovp-threshold = <4650>;
		ti,bq2597x,bat-ovp-alarm-threshold = <4625>;
		ti,bq2597x,bat-ocp-threshold = <7000>;
		ti,bq2597x,bat-ocp-alarm-threshold = <6000>;

		ti,bq2597x,bus-ovp-threshold = <12000>;
		ti,bq2597x,bus-ovp-alarm-threshold = <11000>;
		//ti,bq2597x,bus-ocp-threshold = <2200>;
		//ti,bq2597x,bus-ocp-alarm-threshold = <2000>;
		ti,bq2597x,bus-ocp-threshold = <4000>;
		ti,bq2597x,bus-ocp-alarm-threshold = <3500>;

		//ti,bq2597x,bat-ucp-alarm-threshold = <2000>;

		ti,bq2597x,bat-therm-threshold = <0x15>;/*4.1%*/
		ti,bq2597x,bus-therm-threshold = <0x15>;/*4.1%*/
		ti,bq2597x,die-therm-threshold = <145>;

		ti,bq2597x,ac-ovp-threshold = <14>;
		sc8551,ac-ovp-threshold = <13>;

		//ti,bq2597x,sense-resistor-mohm = <5>;
	};
};

&cp_qc30 {
	compatible = "xiaomi,cp-qc30";
	status = "okay";
	mi,qc3-bat-volt-max = <4480>;
	mi,qc3-bat-curr-max = <3600>;
	mi,qc3-bus-volt-max = <12000>;
	mi,qc3-bus-curr-max = <2100>;
	mi,qc3-non-ffc-bat-volt-max = <4450>;

	mi,qc3-27w-bat-curr-max = <5400>;
	mi,qc3-27w-bus-curr-max = <2700>;
	mi,qc3p-bat-curr-max = <4500>;
	mi,qc3p-bus-curr-max = <2250>;
	mi,cp-sec-enable;
};

&usbpd_pm {
	compatible = "xiaomi,usbpd-pm";
	status = "okay";
	mi,pd-bat-volt-max = <4480>;
	mi,pd-bat-curr-max = <12400>;
	mi,pd-bus-volt-max = <12000>;
	mi,pd-bus-curr-max = <6200>;
	mi,pd-non-ffc-bat-volt-max = <4450>;
	mi,pd-power-max = <67>; /*charge power max : 67W */
	mi,cp-sec-enable;
};

&usb0phy {
	usb_phy_tuning {
		compatible = "mediatek,phy_tuning";
		u2_enhance  = <2>;
		u2_discth  = <11>;
	};
};

&dsi0 {
	status = "okay";
	#address-cells = <1>;
	#size-cells = <0>;
	panel1@0 {
		compatible = "k10_42_02_0a_dsc_cmd,lcm";
		reg = <0>;
		dvdd-supply = <&wl2866d1_dvdd2>;
		te-gpios = <&pio 41 0>;
		reset-gpios = <&pio 42 0>;
		mi,esd-err-irq-gpio = <&pio 132 0x2002>;
		pinctrl-names = "default";
		port {
			panel_in: endpoint {
				remote-endpoint = <&dsi_out>;
			};
		};
	};
	ports {
		port {
			dsi_out: endpoint {
				remote-endpoint = <&panel_in>;
			};
		};
	};
};

&msdc0 {
	status = "disabled";
};

&msdc1 {
	status = "disabled";
};

/* DISPSYS GPIO standardization */
&pio {
	mtkfb_pins_lcm_err_flag: lcm_err_flag {
		pins_cmd_dat {
			pinmux = <PINMUX_GPIO132__FUNC_GPIO132>;
			slew-rate = <0>;
			bias-disable;
		};
	};
};

&mtkfb {
	pinctrl-names = "lcm_rst_out1_gpio", "lcm_rst_out0_gpio",
		"mode_te_te", "err_flag_init";
	pinctrl-0 = <&mtkfb_pins_lcm_rst_out1_gpio>;
	pinctrl-1 = <&mtkfb_pins_lcm_rst_out0_gpio>;
	pinctrl-2 = <&mtkfb_pins_lcm_dsi_te>;
	pinctrl-3 = <&mtkfb_pins_lcm_err_flag>;
	status = "okay";
};

&dispsys_config {
	pinctrl-names =
		"lcm_rst_out1_gpio", "lcm_rst_out0_gpio",
		"mode_te_te", "err_flag_init";
	pinctrl-0 = <&mtkfb_pins_lcm_rst_out1_gpio>;
	pinctrl-1 = <&mtkfb_pins_lcm_rst_out0_gpio>;
	pinctrl-2 = <&mtkfb_pins_lcm_dsi_te>;
	pinctrl-3 = <&mtkfb_pins_lcm_err_flag>;
	status = "okay";
};
/* DISPSYS GPIO standardization end */

&i2c11 {
	clock-frequency = <400000>;
	aw2028@65 {
		compatible = "awinic,aw2028_i2c";
		reg = <0x65>;
		status = "okay";
	};
};


/* ══════ 板级数据：ares.dts — ares 入口 (lineage-23.2 上传) ══════ */
/*
 * Copyright (C) 2015 MediaTek Inc.
 *
 * This program is free software: you can redistribute it and/or modify
 * it under the terms of the GNU General Public License version 2 as
 * published by the Free Software Foundation.
 *
 * This program is distributed in the hope that it will be useful,
 * but WITHOUT ANY WARRANTY; without even the implied warranty of
 * MERCHANTABILITY or FITNESS FOR A PARTICULAR PURPOSE. See the
 GNU General Public License for more details.
 */


/* ══════════════ 主线格式 GPU 节点（Panfrost / Mali-G77 Valhall）══════════════
 * 由 tools/fix_mainline_contract.py 注入，请勿手工改动；重建 dts 会自动带回。
 *
 * SoC 层 mt6893.dtsi 的 mali@13000000 是 4.14 私有格式：
 *   compatible = "mediatek,mt6893-mali"      主线 schema 无此条
 *   clocks     = <&topckgen 0x69 ...>        11 项私有 2-cell 时钟
 *   interrupts = <0 0x16c 4 ...>             原始数值，未用 GIC 宏
 * 节点名 mali@... 也不符合 arm,mali-bifrost.yaml 的 ^gpu@[a-f0-9]+$，
 * 而 &label 覆盖改不了节点名，故先 /delete-node/ 删除再整体新建。
 * 新节点满足主线契约，让 CONFIG_DRM_PANFROST 能匹配（驱动 of_match 已含
 * arm,mali-valhall-jm），并通过 dtbs_check。
 *
 * 数据依据（官方 MiCode/Xiaomi_Kernel_OpenSource @ ares-r-oss, 4.14）：
 *   - 中断 <0 0x16c 4  0 0x16b 4  0 0x16a 4>
 *         → GIC_SPI 364/363/362 + IRQ_TYPE_LEVEL_HIGH
 *         （0=GIC_SPI, 4=IRQ_TYPE_LEVEL_HIGH；本 dts GIC 为 3-cell，无需减 32；
 *           对照主线 mt8192 的 365/364/363 正好一一对应）
 *   - reg 0x13000000 + 0x4000（与 SoC dtsi 一致）
 *   - 频率/电压：drivers/misc/mediatek/base/power/include/gpufreq_v1/mt6893/
 *                mtk_gpufreq_internal_plat.h
 *
 * 已知限制（主线缺件，不是漏做）：
 *   1) clocks 暂用 clk26m（26 MHz fixed-clock）满足 schema 的 required，并让
 *      panfrost 的 devm_clk_get(dev, NULL) 能取到 clock；真实 MFG PLL / DVFS
 *      需要 clk-mt6893，主线 drivers/clk/mediatek 没有该驱动。
 *   2) mali-supply 指向厂商 PMIC 的 vgpu11 buck；该节点在私有 PMIC 树下，
 *      主线无 MT6359 regulator 驱动，真机 probe 需 regulator 框架兜底。
 *   3) 无 power-domains / IOMMU 绑定，GPU 只能完成 probe，不保证渲染可用。
 *   4) OPP 表为「绑定合规 + 可 probe」的最小集，频率/电压取自上述原厂
 *      平台头的真实限值，不是完整 DVFS 档位；完整档位依赖 1) 的时钟驱动。
 */

/delete-node/ &mali;

/ {
	gpu_opp_table: opp-table-gpu {
		compatible = "operating-points-v2";
		opp-shared;

		/* MT_GPUFREQ_BATT_OC_LIMIT_FREQ / LOW_BATT_VOLT_LIMIT_FREQ = 485000 KHz
		 * PTPOD_DISABLE_VOLT = 75000 (mV x 100) = 750 mV */
		opp-485000000 {
			opp-hz = /bits/ 64 <485000000>;
			opp-microvolt = <750000>;
			clock-latency-ns = <2000>;
		};

		/* MT_GPUFREQ_CUST_INIT_OPP = 836000 KHz
		 * GPU_ACT_REF_VOLT = 80000 (mV x 100) = 800 mV */
		opp-836000000 {
			opp-hz = /bits/ 64 <836000000>;
			opp-microvolt = <800000>;
			clock-latency-ns = <2000>;
		};
	};

	gpu@13000000 {
		compatible = "mediatek,mt6893-mali", "arm,mali-valhall-jm";
		reg = <0 0x13000000 0 0x4000>;
		interrupts = <GIC_SPI 364 IRQ_TYPE_LEVEL_HIGH>,
			     <GIC_SPI 363 IRQ_TYPE_LEVEL_HIGH>,
			     <GIC_SPI 362 IRQ_TYPE_LEVEL_HIGH>;
		interrupt-names = "job", "mmu", "gpu";
		clocks = <&clk26m>;
		clock-names = "core";
		mali-supply = <&mt_pmic_vgpu11_buck_reg>;
		operating-points-v2 = <&gpu_opp_table>;
		status = "okay";
	};
};


/* ══════════════ 主线格式 USB（host 外接设备 / peripheral 共享网络）══════════════
 * 由 tools/fix_mainline_contract.py 注入，请勿手工改动；重建 dts 会自动带回。
 *
 * SoC 层 mt6893.dtsi 的 usb@11201000 是 4.14 私有格式：
 *   compatible = "mediatek,mtu3"                    schema 要求 SoC 专属串 + 通用串
 *   clocks = <&topckgen 0x7b &infracfg_ao ...>     私有 2-cell，主线无 clk-mt6893
 *   phys = <&u2port &mt6360_pmu>                   第二项指向私有 PMIC 中断控制器
 *   usb-role-switch / role-switch-default-mode = "peripheral"  默认设备模式
 * 主线 mtu3 / xhci-mtk 用 devm_clk_bulk_get_optional() 取时钟（可选），
 * 而 mtu3.yaml 的 phys 要求 minItems:1，故保留 phys 但改指已主线化的 &u2port 0。
 *
 * 依据（均为板级 dts 里已合规的主线 binding）：
 *   - tphy: "mediatek,generic-tphy-v2" + u2port（#phy-cells = <1>）
 *   - clk26m（fixed-clock）、vusb33 / otg_vbus（regulator-fixed）
 *   - mediatek,mtu3.yaml / mediatek,mtk-xhci.yaml 的 compatible enum 由
 *     port/dt-bindings/usb-mtu3-mt6893.patch / usb-xhci-mt6893.patch 补入 mt6893 条目
 *
 * 角色切换（主线 cpp 预处理，编译期二选一）：
 *   0 = host（默认）：插 USB WiFi 网卡 / 4G 上网卡 / USB 以太网，需自备硬件
 *   1 = peripheral：  一根 USB 线连 PC，用 ConfigFS 起 RNDIS / ECM / NCM
 *                    gadget 共享 PC 网络，零额外硬件（但借的是 PC 的网络，
 *                    不是本机自带的 WiFi / SIM 卡）。内核 mtu3 已编为
 *                    DUAL_ROLE，两侧驱动都在，只需改下面一行重编 dtb。
 *
 * 已知限制（真机未验证）：
 *   1) clocks 用 clk26m 满足 schema 的 required；主线驱动只做 prepare/enable，
 *      真实 USB 时钟由 bootloader / 硬件默认维持，枚举是否成功需实机确认。
 *   2) peripheral 模式需用户态用 configfs 组 gadget（u_ether / libcomposite），
 *      且不提供 ADB / MTP / fastboot；两种角色不能同时使用。
 *   3) host 模式插外接设备时，固件需自行放入 /lib/firmware，用户态需
 *      wpa_supplicant / ModemManager / dhcpcd，详见 docs/USB-NETWORKING.md。
 *   4) 自带 WiFi（connsys）与蜂窝（CCCI）在任何角色下都不可用，
 *      原因与代价见 docs/NATIVE-NETWORKING.md。
 */

#define ARES_USB_ROLE_HOST        0
#define ARES_USB_ROLE_PERIPHERAL  1
#define ARES_USB_ROLE             ARES_USB_ROLE_HOST   /* 按需要改这一行 */

/ {
	usb@11201000 {
		/delete-property/ clocks;
		/delete-property/ clock-names;
		/delete-property/ phys;
		/delete-property/ usb-role-switch;
		/delete-property/ role-switch-default-mode;
		compatible = "mediatek,mt6893-mtu3", "mediatek,mtu3";
		clocks = <&clk26m>;
		clock-names = "sys_ck";
		phys = <&u2port 0>;
#if ARES_USB_ROLE == ARES_USB_ROLE_HOST
		dr_mode = "host";
#else
		dr_mode = "peripheral";
#endif
		status = "okay";

		usb@0 {
			/delete-property/ clocks;
			/delete-property/ clock-names;
			compatible = "mediatek,mt6893-xhci", "mediatek,mtk-xhci";
			clocks = <&clk26m>;
			clock-names = "sys_ck";
			vbus-supply = <&otg_vbus>;
			vusb33-supply = <&vusb33>;
			status = "okay";
		};
	};
};
