## linux-7.3.3/drivers/misc/mediatek-compat/Kconfig
```kconfig
config MTK_COMPAT_FRAMEWORK_SYMBOLS
	bool "MT6893 class-B framework symbol bridge (clk/iommu/devfreq)"
	depends on OF
	default y
	help
	  Provide function-level mainline-bridged implementations of the 4.14
	  MTK private framework symbols (register_pg_callback, smi_reg_backup_sec,
	  get_cur_vcore_opp, etc.) so ported drivers link without undefined
	  symbols on Linux 7.3.3. Safe to leave enabled: all symbols are __weak
	  and are automatically overridden by any real in-tree implementation.

config MTK_COMPAT_PLATFORM_BRIDGE
	bool "MT6893 platform/HW weak stub bridge"
	depends on OF
	default y
	help
	  __weak + EXPORT_SYMBOL_GPL safety stubs for 4.14 MTK platform/HW
	  helpers that have no mainline equivalent (M4U/PMIC/IOMMU/SPM/etc.).
	  Real platform implementations override these weak symbols.

config MTK_COMPAT_PLATFORM_SYMBOLS
	bool "MT6893 platform symbol resolution (aee_rr/buck_set_mode)"
	depends on OF
	default y
	help
	  Function-level port of aee_rr_rec_clk/aee_rr_curr_clk plus a safe
	  buck_set_mode fallback. Symbols are __weak + EXPORT_SYMBOL_GPL.

config MTK_PLATFORM_SYMBOLS_FORCE
	bool "Force-build guarded platform symbols without ram_console"
	depends on MTK_COMPAT_PLATFORM_SYMBOLS
	default y
	help
	  Compile the aee_rr_rec_clk/aee_rr_curr_clk block even when
	  CONFIG_MTK_RAM_CONSOLE is disabled, using the TU-local static store.
```

## linux-7.3.3/drivers/misc/mediatek-impl/Kconfig
```kconfig
config MTK_ARES_PRIVATE_DRIVERS
	bool "MT6893 Ares MTK private drivers (symbol-level port, 15 drivers)"
	depends on OF
	default y
	help
	  Port 15 MTK 4.14 private drivers (clk-mt6873-pg, emimpu, pseudo_m4u,
	  ppm, spm, freqhopping, clkbuf, pmic/lbat, mtu3, etc.) into the kernel
	  with 7.3.3 API adaptations. 32 symbols resolved via __weak bridge
	  stubs that are auto-overridden by real in-tree platform code.

config MTK_ARES_REAL_SUBSYS
	bool "MT6893 Ares real MTK subsystem implementations (phase D)"
	depends on MTK_ARES_PRIVATE_DRIVERS
	default y
	help
	  Build real subsystem implementations ported from the 4.19 vendor tree
	  (PPM profile/interface, SPM sysfs) to override the corresponding weak
	  stubs. Code-level self-contained only; no real-hardware functionality
	  is implied (mainline lacks the MT6893 SoC layer).
```

## port/integration/Kconfig.fragment
```kconfig
# SPDX-License-Identifier: GPL-2.0
#
# ares (MT6893) 厂商外设驱动 Kconfig 条目（第 2 轮：按实机参数 / 主线框架重写）
# 放置：整体追加到 drivers/misc/Kconfig（由 apply.sh 自动完成）。
# 依赖均为主线 =y 的基础设施，不引入任何 4.14 MTK 私有符号。
#
# ⚠ 关于 REGMAP_I2C（第 5 轮修复，务必保留这段约定）
#   本片段**不对 REGMAP_I2C 写任何 depends on / select**。原因：目标内核树
#   （尤其 mt6893_kernel_ares_mainline 这类已自带部分厂商驱动的树）可能已经有
#   一处同名的 `config REGULATOR_WL2866D ... select REGMAP_I2C`。Kconfig 允许
#   同一符号在多个 Kconfig 文件重复定义并**合并属性**：若两处合并后出现
#   「A select B」+「A depends on B」，就会触发
#       error: recursive dependency detected!
#       symbol REGMAP_I2C is selected by REGULATOR_WL2866D
#       symbol REGULATOR_WL2866D depends on REGMAP_I2C
#   而 REGMAP_I2C 在主线是无 prompt 的 tristate，本来就只能被 select，
#   对它写 depends on 本身就是错的（用户也无法手工打开）。
#   所需基础设施由 ares_defconfig.fragment 的 `CONFIG_REGMAP_I2C=y` 保证，
#   auto_install.sh 会把该行注入 defconfig；9 个驱动编译因此不受影响。
#   若目标树里那处同名定义自身也同时写了 depends on + select，
#   用 tools/fix_kconfig_recursion.py <内核树> 一键消除（安装脚本会自动调用）。

menu "Xiaomi ares (MT6893) vendor peripherals"
	depends on ARCH_MEDIATEK || COMPILE_TEST

config REGULATOR_WL2866D
	tristate "Will Semiconductor WL2866D camera LDO"
	depends on I2C && REGULATOR
	help
	  ares 相机 LDO（wl2866d1/wl2866d2，2 颗 × 4 路）。
	  寄存器/电压换算来自官方 4.14 源码，按主线 regulator/regmap 重写。
	  需要 CONFIG_REGMAP_I2C=y（本包 defconfig 片段已含）。

config LEDS_AW2028
	tristate "Awinic AW2028 3-channel RGB LED"
	depends on I2C && LEDS_CLASS
	help
	  三通道 LED。寄存器组与主线 drivers/leds/leds-aw2013.c 完全一致
	  （已逐项核对 RSTR 0x00/GCR 0x01/LCTR 0x30/LCFG 0x31+x/PWM 0x34+x），
	  并加入 0x33 chip-id 校验。ares 该节点默认注释（实机未贴装）。
	  需要 CONFIG_REGMAP_I2C=y（本包 defconfig 片段已含）。

config HAPTIC_AW8697
	tristate "Awinic AW8697 linear haptic (mainline ff-memless)"
	depends on I2C && INPUT
	select INPUT_FF_MEMLESS
	help
	  线性马达，标准 input/ff-memless 力反馈接口（FF_RUMBLE）。
	  全部寄存器与 vib_* 校准值来自官方 aw8697_reg.h + ares 设备树，无占位。
	  注意与主线 aw86927 是不同芯片（CHIPID 0x97 vs 0x9270），不可只加
	  compatible 复用。需要 CONFIG_REGMAP_I2C=y（本包 defconfig 片段已含）。

config KEYBOARD_ARES_GAMEKEY
	tristate "Xiaomi ares pop-up gamekey (shoulder keys)"
	depends on INPUT && GPIOLIB
	help
	  弹出式肩键：实机 key_left/right = pio111/112，hall = pio4/5。
	  由 DT 标准化层提供标准 key-gpios / hall-gpios。

config ET7480_AUDIOSWITCH
	tristate "ET7480 audio path switch (pinctrl based)"
	depends on I2C && PINCTRL
	help
	  按厂商 dts 的 uart_enable/uart_disable 两个 pinctrl 状态切换通路，
	  通过 sysfs et7480_switch 控制；不猜寄存器。

config NFC_ST21NFC_ARES
	tristate "ST21NFC I2C passthrough (/dev/st21nfc)"
	depends on I2C && GPIOLIB
	help
	  保留 Android HAL 的 /dev/st21nfc + read/write/poll/ioctl 契约；
	  实机 reset/irq = pio10/11，经 DT 标准化为 reset-gpios/irq-gpios。

config CHARGER_XMUSB350
	tristate "Xiaomi XMUSB350 USB charge detection"
	depends on I2C && POWER_SUPPLY && GPIOLIB
	help
	  注册 USB charger power_supply，读取实机 en_bc12/en_hvdcp/en_intb/
	  en_sleep 与 pio28/205/204/29/110 GPIO。寄存器地址官方未开源，
	  以 DT 属性 xm,status-reg 可配，不虚构。

config SPI_GF3658
	tristate "Goodix GF3658 fingerprint (mainline HAL contract)"
	depends on SPI && INPUT && GPIOLIB && REGULATOR
	help
	  完整移植内核侧 HAL 契约：/dev/goodix_fp + 18 个 GF_IOC_* ioctl +
	  poll/read/write/fasync 事件（取代私有 netlink）+ 官方 REE SPI 协议
	  (0xF0/0xF1) + gpiod 复位/中断 + regulator 电源。
	  TEE TA 内的指纹采集不属内核职责，无需移植。

config TOUCHSCREEN_GT9886
	tristate "Goodix GT9886/GT9896S touchscreen (official GTX8 protocol)"
	depends on I2C && INPUT && GPIOLIB && REGULATOR
	help
	  按官方 ares-r-oss 真实协议实现的可用触控驱动：0x824E 坐标帧、
	  BYTES_PER_COORD=8、coord_sta/checksum/pen/key、0x30F0 doze 握手、
	  官方 DT 参数（1080x2280/10 点/irq-flags=2），主线 i2c+input-mt。
	  实机 BOM 由 k6893v1_64_defconfig 确认为 GT9886/GT9896S。

endmenu
```

## wifi-vendor-port/framework/Kconfig.fragment
```kconfig
# B 类（clk/iommu/devfreq）框架符号接线 —— Kconfig 片段
# 挂到目标树 drivers/misc/mediatek/ 或统一的 ares 平台 Kconfig 下。
#
# 路径 A（推荐，7.3.3 主线框架）：只开本项，不编 framework/vendor/ 下的
#   4.14 私有 clk/iommu/devfreq 驱动；主线 clk-mtk / mtk-smi / mtk_iommu /
#   mtk-dvfsrc / mtk-pm-domains 提供同名子系统。
# 路径 B（目标树确实移植了整套 4.14 私有框架）：同样可开本项，
#   __weak 定义会被强符号自动覆盖，不产生 multiple definition。

config MTK_FRAMEWORK_SYMBOLS
	tristate "MT6893 class-B (clk/iommu/devfreq) framework symbol bridge"
	depends on ARM64
	default y
	help
	  Provides link-time resolution for the 4.14 MediaTek platform symbols
	  that are strongly coupled with mainline frameworks:

	    register_pg_callback   (clk / power-gating callback chain)
	    smi_reg_backup_sec     (iommu / SMI register save)
	    smi_reg_restore_sec    (iommu / SMI register restore)
	    get_cur_vcore_opp      (devfreq / DVFSRC VCORE OPP)

	  All definitions are __weak + EXPORT_SYMBOL_GPL, so a target tree that
	  already ships real implementations (path B) takes precedence silently.
	  aee_rr_rec_clk (the 5th class-B symbol) is provided separately by
	  solution/platform-symbols.c (stage-4).

	  Source references (all GitHub open source, blob-sha verified):
	    torvalds/linux@master                     -> framework/upstream/
	    xiaomi-mt6893-dev/kernel_xiaomi_mt6893   -> framework/vendor/
	  See docs/CLASS-B-ADAPTATION.md for wiring of the optional bridge
	  entry points (mtk_pg_notify / mtk_framework_set_vcore_opp / ...).

config MTK_FRAMEWORK_HAVE_PG_H
	bool "Use vendor clk-mt6873-pg.h types instead of standalone ABI shim"
	depends on MTK_FRAMEWORK_SYMBOLS
	default n
	help
	  Enable only if the target tree actually puts the 4.14 private
	  drivers/clk/mediatek/clk-mt6873-pg.h on the include path. When enabled,
	  framework-symbols.c uses the real 'enum subsys_id' and
	  'struct pg_callbacks' from that header instead of the minimal ABI
	  compatible definition in compat/mtk_framework_compat.h.
	  Both configurations are compile-verified by solution/verify-class-b.sh.
```
